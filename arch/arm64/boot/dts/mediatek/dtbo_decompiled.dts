/dts-v1/;

/ {

	fragment@0 {
		target = <0xffffffff>;

		__overlay__ {
		};
	};

	fragment@1 {
		target = <0xffffffff>;

		__overlay__ {
			atag,videolfb-fb_base_l = "~`P";
			atag,videolfb-fb_base_h = <0x00>;
			atag,videolfb-islcmfound = <0x01>;
			atag,videolfb-islcm_inited = <0x00>;
			atag,videolfb-fps = <0x1770>;
			atag,videolfb-vramSize = <0x17e8000>;
			atag,videolfb-lcmname = "nt35695_fhd_dsi_cmd_truly_rt5081_drv";
		};
	};

	fragment@2 {
		target = <0xffffffff>;

		__overlay__ {

			cam_vdd_ext {
				compatible = "mediatek,cam_vdd_ext";
				pinctrl-names = "extldodefault\0extldo_en_high\0extldo_en_low";
				pinctrl-0 = <0x01>;
				pinctrl-1 = <0x02>;
				pinctrl-2 = <0x03>;
				status = "okay";
				phandle = <0x56>;
			};

			flashlights_aw36515 {
				compatible = "mediatek,flashlights_aw36515";
				pinctrl-names = "aw36515default\0aw36515hwen_high\0aw36515hwen_low";
				pinctrl-0 = <0x04>;
				pinctrl-1 = <0x05>;
				pinctrl-2 = <0x06>;
				status = "okay";
				phandle = <0x57>;
			};

			flashlights_ocp81375 {
				compatible = "mediatek,flashlights_ocp81375";
				pinctrl-names = "ocp81375default\0ocp81375hwen_high\0ocp81375hwen_low";
				pinctrl-0 = <0x07>;
				pinctrl-1 = <0x08>;
				pinctrl-2 = <0x09>;
				status = "okay";
				phandle = <0x58>;
			};

			lens_actuator_main_af {
				compatible = "lens_actuator_main_af";
				pinctrl-names = "cam0vcamafdefault\0cam0_ldo_vcamaf_1\0cam0_ldo_vcamaf_0";
				pinctrl-0 = <0x0a>;
				pinctrl-1 = <0x0b>;
				pinctrl-2 = <0x0c>;
				status = "okay";
				phandle = <0x59>;
			};

			led@0 {
				compatible = "mediatek,red";
				led_mode = <0x00>;
				data = <0x01>;
				pwm_config = <0x00 0x00 0x00 0x00 0x00>;
				phandle = <0x5a>;
			};

			led@1 {
				compatible = "mediatek,green";
				led_mode = <0x00>;
				data = <0x01>;
				pwm_config = <0x00 0x00 0x00 0x00 0x00>;
				phandle = <0x5b>;
			};

			led@2 {
				compatible = "mediatek,blue";
				led_mode = <0x00>;
				data = <0x01>;
				pwm_config = <0x00 0x00 0x00 0x00 0x00>;
				phandle = <0x5c>;
			};

			led@3 {
				compatible = "mediatek,jogball-backlight";
				led_mode = <0x00>;
				data = <0x01>;
				pwm_config = <0x00 0x00 0x00 0x00 0x00>;
				phandle = <0x5d>;
			};

			led@4 {
				compatible = "mediatek,keyboard-backlight";
				led_mode = <0x00>;
				data = <0x01>;
				pwm_config = <0x00 0x00 0x00 0x00 0x00>;
				phandle = <0x5e>;
			};

			led@5 {
				compatible = "mediatek,button-backlight";
				led_mode = <0x00>;
				data = <0x01>;
				pwm_config = <0x00 0x00 0x00 0x00 0x00>;
				phandle = <0x5f>;
			};

			led@6 {
				compatible = "mediatek,lcd-backlight";
				led_mode = <0x05>;
				data = <0x01>;
				pwm_config = <0x00 0x01 0x00 0x00 0x00>;
				phandle = <0x60>;
			};

			vibrator@0 {
				compatible = "mediatek,vibrator";
				vib_timer = <0x19>;
				vib_limit = <0x09>;
				vib_vol = <0x09>;
				phandle = <0x61>;
			};

			tran_audio {
				compatible = "tran_audio,audio";
				extamp_gpio = <0xffffffff 0xa4 0x00>;
				dual_speaker_gpio = <0xffffffff 0xa5 0x00>;
				extamp_mode = <0x02>;
				extamp_speech_mode = <0x02>;
				receiver_mode = <0x06>;
				phandle = <0x62>;
			};

			usb_c_pinctrl {
				compatible = "mediatek,usb_c_pinctrl";
				phandle = <0x63>;
			};

			fingerprint {
				compatible = "tran_fp";
				interrupt-parent = <0xffffffff>;
				interrupts = <0x01 0x01 0x01 0x00>;
				debounce = <0x01 0x00>;
				pinctrl-names = "tran_fp_default\0tran_fp_pin_irq\0tran_fp_irq_pull_down\0tran_fp_reset_high\0tran_fp_reset_low";
				pinctrl-0 = <0x0d>;
				pinctrl-1 = <0x0e>;
				pinctrl-2 = <0x0f>;
				pinctrl-3 = <0x10>;
				pinctrl-4 = <0x11>;
				status = "okay";
				phandle = <0x64>;
			};
		};
	};

	fragment@3 {
		target = <0xffffffff>;

		__overlay__ {

			fingerprint@0 {
				compatible = "tran_fp";
				reg = <0x00>;
				spi-max-frequency = <0x19bfcc0>;
				interrupt-parent = <0xffffffff>;
				interrupts = <0x01 0x01 0x01 0x00>;
				debounce = <0x01 0x00>;
				irq-gpio = <0x01>;
				irq-gpio-std = <0xffffffff 0x01 0x00>;
				reset-gpio = <0x07>;
				reset-gpio-std = <0xffffffff 0x07 0x00>;
				vmch-supply = <0xffffffff>;
				pinctrl-names = "tran_fp_default\0tran_fp_pin_irq\0tran_fp_irq_pull_down\0tran_fp_reset_high\0tran_fp_reset_low\0tran_fp_spi_default";
				pinctrl-0 = <0x0d>;
				pinctrl-1 = <0x0e>;
				pinctrl-2 = <0x0f>;
				pinctrl-3 = <0x10>;
				pinctrl-4 = <0x11>;
				pinctrl-5 = <0x12>;
				status = "okay";
			};
		};
	};

	fragment@4 {
		target = <0xffffffff>;

		__overlay__ {

			fingerprint_default {
				phandle = <0x0d>;
			};

			gpio1_eint {
				phandle = <0x0e>;

				pins_cmd_dat {
					pinmux = <0x100>;
					slew-rate = <0x00>;
					bias-disable;
				};
			};

			gpio1_eint_pull_down {
				phandle = <0x0f>;

				pins_cmd_dat {
					pinmux = <0x100>;
					slew-rate = <0x00>;
					bias-pull-down = <0x00>;
					output-low;
				};
			};

			rst_out_one {
				phandle = <0x10>;

				pins_cmd_dat {
					pinmux = <0x700>;
					slew-rate = <0x01>;
					bias-disable;
					output-high;
				};
			};

			rst_out_zero {
				phandle = <0x11>;

				pins_cmd_dat {
					pinmux = <0x700>;
					slew-rate = <0x01>;
					bias-disable;
					output-low;
				};
			};

			spimode_default {
				phandle = <0x12>;

				pins_cmd_dat {
					pinmux = <0x2701 0x2601 0x2501 0x2401>;
					drive-strength = <0x00>;
				};
			};
		};
	};

	fragment@5 {
		target = <0xffffffff>;

		__overlay__ {
			compatible = "mediatek,touch";
			tpd-resolution = <0x438 0x99c>;
			use-tpd-button = <0x00>;
			tpd-key-num = <0x03>;
			tpd-key-local = <0x8b 0xac 0x9e 0x00>;
			tpd-key-dim-local = <0x5a 0x373 0x64 0x28 0xe6 0x373 0x64 0x28 0x172 0x373 0x64 0x28 0x00 0x00 0x00 0x00>;
			tpd-max-touch-num = <0x0a>;
			tpd-filter-enable = <0x00>;
			tpd-filter-pixel-density = <0xa8>;
			tpd-filter-custom-prameters = <0x00 0x00 0x00 0x00 0x00 0x00 0x00 0x00 0x00 0x00 0x00 0x00>;
			tpd-filter-custom-speed = <0x00 0x00 0x00>;
			pinctrl-names = "default\0state_eint_as_int\0state_eint_output0\0state_eint_output1\0state_rst_output0\0state_rst_output1";
			pinctrl-0 = <0x13>;
			pinctrl-1 = <0x14>;
			pinctrl-2 = <0x15>;
			pinctrl-3 = <0x16>;
			pinctrl-4 = <0x17>;
			pinctrl-5 = <0x18>;
			status = "okay";
		};
	};

	fragment@6 {
		target = <0xffffffff>;

		__overlay__ {

			eint0default {
				phandle = <0x13>;
			};

			eint@0 {
				phandle = <0x14>;

				pins_cmd_dat {
					pinmux = <0xf00>;
					slew-rate = <0x00>;
					bias-disable;
				};
			};

			eintoutput0 {
				phandle = <0x15>;

				pins_cmd_dat {
					pinmux = <0xf00>;
					slew-rate = <0x01>;
					output-low;
				};
			};

			eintoutput1 {
				phandle = <0x16>;

				pins_cmd_dat {
					pinmux = <0xf00>;
					slew-rate = <0x01>;
					output-high;
				};
			};

			rstoutput0 {
				phandle = <0x17>;

				pins_cmd_dat {
					pinmux = <0x1000>;
					slew-rate = <0x01>;
					output-low;
				};
			};

			rstoutput1 {
				phandle = <0x18>;

				pins_cmd_dat {
					pinmux = <0x1000>;
					slew-rate = <0x01>;
					output-high;
				};
			};
		};
	};

	fragment@7 {
		target = <0xffffffff>;

		__overlay__ {

			touch@0 {
				compatible = "novatek,NVT-ts-spi";
				reg = <0x00>;
				spi-max-frequency = <0x7a1200>;
				status = "okay";
				novatek,swrst-n8-addr = <0x3f0fe>;
				novatek,spi-rd-fast-addr = <0x3f310>;
				novatek,mp-support-dt;
				phandle = <0x65>;

				novatek-mp-criteria-625a@0 {
					#address-cells = <0x01>;
					#size-cells = <0x00>;
					compatible = "novatek-mp-criteria-625a";
					IC_X_CFG_SIZE = <0x12>;
					IC_Y_CFG_SIZE = <0x24>;
					IC_KEY_CFG_SIZE = <0x04>;
					X_Channel = <0x12>;
					Y_Channel = <0x24>;
					AIN_X = <0x00 0x01 0x02 0x03 0x04 0x05 0x06 0x07 0x08 0x09 0x0a 0x0b 0x0c 0x0d 0x0e 0x0f 0x10 0x11>;
					AIN_Y = <0x00 0x01 0x02 0x03 0x04 0x05 0x06 0x07 0x08 0x09 0x0a 0x0b 0x0c 0x0d 0x0e 0x0f 0x10 0x11 0x12 0x13 0x14 0x15 0x16 0x17 0x18 0x19 0x1a 0x1b 0x1c 0x1d 0x1e 0x1f 0x20 0x21 0x22 0x23>;
					AIN_KEY = <0x00 0x01 0x02 0xff>;
					PS_Config_Lmt_Short_Rawdata_P = <0x36b8 0x36b8 0x36b8 0x36b8 0x36b8 0x36b8 0x36b8 0x36b8 0x36b8 0x36b8 0x36b8 0x36b8 0x36b8 0x36b8 0x36b8 0x36b8 0x36b8 0x36b8 0x36b8 0x36b8 0x36b8 0x36b8 0x36b8 0x36b8 0x36b8 0x36b8 0x36b8 0x36b8 0x36b8 0x36b8 0x36b8 0x36b8 0x36b8 0x36b8 0x36b8 0x36b8 0x36b8 0x36b8 0x36b8 0x36b8 0x36b8 0x36b8 0x36b8 0x36b8 0x36b8 0x36b8 0x36b8 0x36b8 0x36b8 0x36b8 0x36b8 0x36b8 0x36b8 0x36b8 0x36b8 0x36b8 0x36b8 0x36b8 0x36b8 0x36b8 0x36b8 0x36b8 0x36b8 0x36b8 0x36b8 0x36b8 0x36b8 0x36b8 0x36b8 0x36b8 0x36b8 0x36b8 0x36b8 0x36b8 0x36b8 0x36b8 0x36b8 0x36b8 0x36b8 0x36b8 0x36b8 0x36b8 0x36b8 0x36b8 0x36b8 0x36b8 0x36b8 0x36b8 0x36b8 0x36b8 0x36b8 0x36b8 0x36b8 0x36b8 0x36b8 0x36b8 0x36b8 0x36b8 0x36b8 0x36b8 0x36b8 0x36b8 0x36b8 0x36b8 0x36b8 0x36b8 0x36b8 0x36b8 0x36b8 0x36b8 0x36b8 0x36b8 0x36b8 0x36b8 0x36b8 0x36b8 0x36b8 0x36b8 0x36b8 0x36b8 0x36b8 0x36b8 0x36b8 0x36b8 0x36b8 0x36b8 0x36b8 0x36b8 0x36b8 0x36b8 0x36b8 0x36b8 0x36b8 0x36b8 0x36b8 0x36b8 0x36b8 0x36b8 0x36b8 0x36b8 0x36b8 0x36b8 0x36b8 0x36b8 0x36b8 0x36b8 0x36b8 0x36b8 0x36b8 0x36b8 0x36b8 0x36b8 0x36b8 0x36b8 0x36b8 0x36b8 0x36b8 0x36b8 0x36b8 0x36b8 0x36b8 0x36b8 0x36b8 0x36b8 0x36b8 0x36b8 0x36b8 0x36b8 0x36b8 0x36b8 0x36b8 0x36b8 0x36b8 0x36b8 0x36b8 0x36b8 0x36b8 0x36b8 0x36b8 0x36b8 0x36b8 0x36b8 0x36b8 0x36b8 0x36b8 0x36b8 0x36b8 0x36b8 0x36b8 0x36b8 0x36b8 0x36b8 0x36b8 0x36b8 0x36b8 0x36b8 0x36b8 0x36b8 0x36b8 0x36b8 0x36b8 0x36b8 0x36b8 0x36b8 0x36b8 0x36b8 0x36b8 0x36b8 0x36b8 0x36b8 0x36b8 0x36b8 0x36b8 0x36b8 0x36b8 0x36b8 0x36b8 0x36b8 0x36b8 0x36b8 0x36b8 0x36b8 0x36b8 0x36b8 0x36b8 0x36b8 0x36b8 0x36b8 0x36b8 0x36b8 0x36b8 0x36b8 0x36b8 0x36b8 0x36b8 0x36b8 0x36b8 0x36b8 0x36b8 0x36b8 0x36b8 0x36b8 0x36b8 0x36b8 0x36b8 0x36b8 0x36b8 0x36b8 0x36b8 0x36b8 0x36b8 0x36b8 0x36b8 0x36b8 0x36b8 0x36b8 0x36b8 0x36b8 0x36b8 0x36b8 0x36b8 0x36b8 0x36b8 0x36b8 0x36b8 0x36b8 0x36b8 0x36b8 0x36b8 0x36b8 0x36b8 0x36b8 0x36b8 0x36b8 0x36b8 0x36b8 0x36b8 0x36b8 0x36b8 0x36b8 0x36b8 0x36b8 0x36b8 0x36b8 0x36b8 0x36b8 0x36b8 0x36b8 0x36b8 0x36b8 0x36b8 0x36b8 0x36b8 0x36b8 0x36b8 0x36b8 0x36b8 0x36b8 0x36b8 0x36b8 0x36b8 0x36b8 0x36b8 0x36b8 0x36b8 0x36b8 0x36b8 0x36b8 0x36b8 0x36b8 0x36b8 0x36b8 0x36b8 0x36b8 0x36b8 0x36b8 0x36b8 0x36b8 0x36b8 0x36b8 0x36b8 0x36b8 0x36b8 0x36b8 0x36b8 0x36b8 0x36b8 0x36b8 0x36b8 0x36b8 0x36b8 0x36b8 0x36b8 0x36b8 0x36b8 0x36b8 0x36b8 0x36b8 0x36b8 0x36b8 0x36b8 0x36b8 0x36b8 0x36b8 0x36b8 0x36b8 0x36b8 0x36b8 0x36b8 0x36b8 0x36b8 0x36b8 0x36b8 0x36b8 0x36b8 0x36b8 0x36b8 0x36b8 0x36b8 0x36b8 0x36b8 0x36b8 0x36b8 0x36b8 0x36b8 0x36b8 0x36b8 0x36b8 0x36b8 0x36b8 0x36b8 0x36b8 0x36b8 0x36b8 0x36b8 0x36b8 0x36b8 0x36b8 0x36b8 0x36b8 0x36b8 0x36b8 0x36b8 0x36b8 0x36b8 0x36b8 0x36b8 0x36b8 0x36b8 0x36b8 0x36b8 0x36b8 0x36b8 0x36b8 0x36b8 0x36b8 0x36b8 0x36b8 0x36b8 0x36b8 0x36b8 0x36b8 0x36b8 0x36b8 0x36b8 0x36b8 0x36b8 0x36b8 0x36b8 0x36b8 0x36b8 0x36b8 0x36b8 0x36b8 0x36b8 0x36b8 0x36b8 0x36b8 0x36b8 0x36b8 0x36b8 0x36b8 0x36b8 0x36b8 0x36b8 0x36b8 0x36b8 0x36b8 0x36b8 0x36b8 0x36b8 0x36b8 0x36b8 0x36b8 0x36b8 0x36b8 0x36b8 0x36b8 0x36b8 0x36b8 0x36b8 0x36b8 0x36b8 0x36b8 0x36b8 0x36b8 0x36b8 0x36b8 0x36b8 0x36b8 0x36b8 0x36b8 0x36b8 0x36b8 0x36b8 0x36b8 0x36b8 0x36b8 0x36b8 0x36b8 0x36b8 0x36b8 0x36b8 0x36b8 0x36b8 0x36b8 0x36b8 0x36b8 0x36b8 0x36b8 0x36b8 0x36b8 0x36b8 0x36b8 0x36b8 0x36b8 0x36b8 0x36b8 0x36b8 0x36b8 0x36b8 0x36b8 0x36b8 0x36b8 0x36b8 0x36b8 0x36b8 0x36b8 0x36b8 0x36b8 0x36b8 0x36b8 0x36b8 0x36b8 0x36b8 0x36b8 0x36b8 0x36b8 0x36b8 0x36b8 0x36b8 0x36b8 0x36b8 0x36b8 0x36b8 0x36b8 0x36b8 0x36b8 0x36b8 0x36b8 0x36b8 0x36b8 0x36b8 0x36b8 0x36b8 0x36b8 0x36b8 0x36b8 0x36b8 0x36b8 0x36b8 0x36b8 0x36b8 0x36b8 0x36b8 0x36b8 0x36b8 0x36b8 0x36b8 0x36b8 0x36b8 0x36b8 0x36b8 0x36b8 0x36b8 0x36b8 0x36b8 0x36b8 0x36b8 0x36b8 0x36b8 0x36b8 0x36b8 0x36b8 0x36b8 0x36b8 0x36b8 0x36b8 0x36b8 0x36b8 0x36b8 0x36b8 0x36b8 0x36b8 0x36b8 0x36b8 0x36b8 0x36b8 0x36b8 0x36b8 0x36b8 0x36b8 0x36b8 0x36b8 0x36b8 0x36b8 0x36b8 0x36b8 0x36b8 0x36b8 0x36b8 0x36b8 0x36b8 0x36b8 0x36b8 0x36b8 0x36b8 0x36b8 0x36b8 0x36b8 0x36b8 0x36b8 0x36b8 0x36b8 0x36b8 0x36b8 0x36b8 0x36b8 0x36b8 0x36b8 0x36b8 0x36b8 0x36b8 0x36b8 0x36b8 0x36b8 0x36b8 0x36b8 0x36b8 0x36b8 0x36b8 0x36b8 0x36b8 0x36b8 0x36b8 0x36b8 0x36b8 0x36b8 0x36b8 0x36b8 0x36b8 0x36b8 0x36b8 0x36b8 0x36b8 0x36b8 0x36b8 0x36b8 0x36b8 0x36b8 0x36b8 0x36b8 0x36b8 0x36b8 0x36b8 0x36b8 0x36b8 0x36b8 0x36b8 0x36b8 0x36b8 0x36b8 0x36b8 0x36b8 0x36b8 0x36b8 0x36b8 0x36b8 0x36b8 0x36b8 0x36b8 0x36b8 0x36b8 0x36b8 0x36b8 0x36b8 0x36b8 0x36b8 0x36b8 0x36b8 0x36b8>;
					PS_Config_Lmt_Short_Rawdata_N = <0x2774 0x2774 0x2774 0x2774 0x2774 0x2774 0x2774 0x2774 0x2774 0x2774 0x2774 0x2774 0x2774 0x2774 0x2774 0x2774 0x2774 0x2774 0x2774 0x2774 0x2774 0x2774 0x2774 0x2774 0x2774 0x2774 0x2774 0x2774 0x2774 0x2774 0x2774 0x2774 0x2774 0x2774 0x2774 0x2774 0x2774 0x2774 0x2774 0x2774 0x2774 0x2774 0x2774 0x2774 0x2774 0x2774 0x2774 0x2774 0x2774 0x2774 0x2774 0x2774 0x2774 0x2774 0x2774 0x2774 0x2774 0x2774 0x2774 0x2774 0x2774 0x2774 0x2774 0x2774 0x2774 0x2774 0x2774 0x2774 0x2774 0x2774 0x2774 0x2774 0x2774 0x2774 0x2774 0x2774 0x2774 0x2774 0x2774 0x2774 0x2774 0x2774 0x2774 0x2774 0x2774 0x2774 0x2774 0x2774 0x2774 0x2774 0x2774 0x2774 0x2774 0x2774 0x2774 0x2774 0x2774 0x2774 0x2774 0x2774 0x2774 0x2774 0x2774 0x2774 0x2774 0x2774 0x2774 0x2774 0x2774 0x2774 0x2774 0x2774 0x2774 0x2774 0x2774 0x2774 0x2774 0x2774 0x2774 0x2774 0x2774 0x2774 0x2774 0x2774 0x2774 0x2774 0x2774 0x2774 0x2774 0x2774 0x2774 0x2774 0x2774 0x2774 0x2774 0x2774 0x2774 0x2774 0x2774 0x2774 0x2774 0x2774 0x2774 0x2774 0x2774 0x2774 0x2774 0x2774 0x2774 0x2774 0x2774 0x2774 0x2774 0x2774 0x2774 0x2774 0x2774 0x2774 0x2774 0x2774 0x2774 0x2774 0x2774 0x2774 0x2774 0x2774 0x2774 0x2774 0x2774 0x2774 0x2774 0x2774 0x2774 0x2774 0x2774 0x2774 0x2774 0x2774 0x2774 0x2774 0x2774 0x2774 0x2774 0x2774 0x2774 0x2774 0x2774 0x2774 0x2774 0x2774 0x2774 0x2774 0x2774 0x2774 0x2774 0x2774 0x2774 0x2774 0x2774 0x2774 0x2774 0x2774 0x2774 0x2774 0x2774 0x2774 0x2774 0x2774 0x2774 0x2774 0x2774 0x2774 0x2774 0x2774 0x2774 0x2774 0x2774 0x2774 0x2774 0x2774 0x2774 0x2774 0x2774 0x2774 0x2774 0x2774 0x2774 0x2774 0x2774 0x2774 0x2774 0x2774 0x2774 0x2774 0x2774 0x2774 0x2774 0x2774 0x2774 0x2774 0x2774 0x2774 0x2774 0x2774 0x2774 0x2774 0x2774 0x2774 0x2774 0x2774 0x2774 0x2774 0x2774 0x2774 0x2774 0x2774 0x2774 0x2774 0x2774 0x2774 0x2774 0x2774 0x2774 0x2774 0x2774 0x2774 0x2774 0x2774 0x2774 0x2774 0x2774 0x2774 0x2774 0x2774 0x2774 0x2774 0x2774 0x2774 0x2774 0x2774 0x2774 0x2774 0x2774 0x2774 0x2774 0x2774 0x2774 0x2774 0x2774 0x2774 0x2774 0x2774 0x2774 0x2774 0x2774 0x2774 0x2774 0x2774 0x2774 0x2774 0x2774 0x2774 0x2774 0x2774 0x2774 0x2774 0x2774 0x2774 0x2774 0x2774 0x2774 0x2774 0x2774 0x2774 0x2774 0x2774 0x2774 0x2774 0x2774 0x2774 0x2774 0x2774 0x2774 0x2774 0x2774 0x2774 0x2774 0x2774 0x2774 0x2774 0x2774 0x2774 0x2774 0x2774 0x2774 0x2774 0x2774 0x2774 0x2774 0x2774 0x2774 0x2774 0x2774 0x2774 0x2774 0x2774 0x2774 0x2774 0x2774 0x2774 0x2774 0x2774 0x2774 0x2774 0x2774 0x2774 0x2774 0x2774 0x2774 0x2774 0x2774 0x2774 0x2774 0x2774 0x2774 0x2774 0x2774 0x2774 0x2774 0x2774 0x2774 0x2774 0x2774 0x2774 0x2774 0x2774 0x2774 0x2774 0x2774 0x2774 0x2774 0x2774 0x2774 0x2774 0x2774 0x2774 0x2774 0x2774 0x2774 0x2774 0x2774 0x2774 0x2774 0x2774 0x2774 0x2774 0x2774 0x2774 0x2774 0x2774 0x2774 0x2774 0x2774 0x2774 0x2774 0x2774 0x2774 0x2774 0x2774 0x2774 0x2774 0x2774 0x2774 0x2774 0x2774 0x2774 0x2774 0x2774 0x2774 0x2774 0x2774 0x2774 0x2774 0x2774 0x2774 0x2774 0x2774 0x2774 0x2774 0x2774 0x2774 0x2774 0x2774 0x2774 0x2774 0x2774 0x2774 0x2774 0x2774 0x2774 0x2774 0x2774 0x2774 0x2774 0x2774 0x2774 0x2774 0x2774 0x2774 0x2774 0x2774 0x2774 0x2774 0x2774 0x2774 0x2774 0x2774 0x2774 0x2774 0x2774 0x2774 0x2774 0x2774 0x2774 0x2774 0x2774 0x2774 0x2774 0x2774 0x2774 0x2774 0x2774 0x2774 0x2774 0x2774 0x2774 0x2774 0x2774 0x2774 0x2774 0x2774 0x2774 0x2774 0x2774 0x2774 0x2774 0x2774 0x2774 0x2774 0x2774 0x2774 0x2774 0x2774 0x2774 0x2774 0x2774 0x2774 0x2774 0x2774 0x2774 0x2774 0x2774 0x2774 0x2774 0x2774 0x2774 0x2774 0x2774 0x2774 0x2774 0x2774 0x2774 0x2774 0x2774 0x2774 0x2774 0x2774 0x2774 0x2774 0x2774 0x2774 0x2774 0x2774 0x2774 0x2774 0x2774 0x2774 0x2774 0x2774 0x2774 0x2774 0x2774 0x2774 0x2774 0x2774 0x2774 0x2774 0x2774 0x2774 0x2774 0x2774 0x2774 0x2774 0x2774 0x2774 0x2774 0x2774 0x2774 0x2774 0x2774 0x2774 0x2774 0x2774 0x2774 0x2774 0x2774 0x2774 0x2774 0x2774 0x2774 0x2774 0x2774 0x2774 0x2774 0x2774 0x2774 0x2774 0x2774 0x2774 0x2774 0x2774 0x2774 0x2774 0x2774 0x2774 0x2774 0x2774 0x2774 0x2774 0x2774 0x2774 0x2774 0x2774 0x2774 0x2774 0x2774 0x2774 0x2774 0x2774 0x2774 0x2774 0x2774 0x2774 0x2774 0x2774 0x2774 0x2774 0x2774 0x2774 0x2774 0x2774 0x2774 0x2774 0x2774 0x2774 0x2774 0x2774 0x2774 0x2774 0x2774 0x2774 0x2774 0x2774 0x2774 0x2774 0x2774 0x2774 0x2774 0x2774 0x2774 0x2774 0x2774 0x2774 0x2774 0x2774 0x2774 0x2774 0x2774 0x2774 0x2774 0x2774 0x2774 0x2774 0x2774 0x2774 0x2774 0x2774 0x2774 0x2774 0x2774 0x2774 0x2774 0x2774 0x2774 0x2774 0x2774 0x2774 0x2774 0x2774 0x2774 0x2774>;
					PS_Config_Lmt_Open_Rawdata_P = <0xc87 0xd4c 0xd53 0xd55 0xd43 0xd2c 0xd2c 0xd16 0xc02 0xcce 0xe0c 0xe1c 0xe07 0xe17 0xdd4 0xd9b 0xd5c 0xc21 0xc9c 0xd58 0xd51 0xd51 0xd40 0xd25 0xd20 0xd0b 0xc08 0xcc3 0xde8 0xdf6 0xde1 0xdfa 0xdba 0xd8a 0xd53 0xc6a 0xd68 0xd80 0xd7b 0xd76 0xd66 0xd48 0xd48 0xd30 0xd24 0xe00 0xdfa 0xdfe 0xdf4 0xe08 0xdd3 0xd9c 0xd71 0xd1a 0xd95 0xd9b 0xd98 0xd90 0xd7c 0xd60 0xd63 0xd47 0xd1b 0xe04 0xdfb 0xe02 0xdf4 0xe08 0xdd8 0xda0 0xd79 0xd10 0xdbf 0xdbe 0xdb4 0xdae 0xda2 0xd80 0xd82 0xd63 0xd64 0xe1a 0xe10 0xe1d 0xe16 0xe25 0xdf4 0xdcd 0xd9f 0xd78 0xdf2 0xde1 0xdd3 0xdd4 0xdbf 0xd9b 0xd9e 0xd82 0xd80 0xe16 0xe0f 0xe1e 0xe16 0xe21 0xdfb 0xdcf 0xd9e 0xd89 0xdf4 0xdef 0xde2 0xde2 0xdd0 0xdb0 0xdac 0xd91 0xd95 0xe2a 0xe24 0xe33 0xe20 0xe3a 0xe1c 0xde8 0xdb8 0xdb5 0xe02 0xe04 0xdf6 0xdf2 0xdde 0xdc3 0xdbe 0xd86 0xdb3 0xe2a 0xe20 0xe31 0xe1c 0xe33 0xe10 0xddf 0xd8e 0xdac 0xe12 0xe0e 0xe09 0xe00 0xded 0xdcc 0xdcd 0xdbb 0xdc8 0xe2b 0xe28 0xe2c 0xe21 0xe35 0xe28 0xdf2 0xdd1 0xdc5 0xe23 0xe1e 0xe1d 0xe0f 0xdfe 0xdde 0xde1 0xdd4 0xde9 0xe51 0xe46 0xe48 0xe3d 0xe4a 0xe35 0xdfe 0xde8 0xddb 0xe36 0xe3f 0xe31 0xe31 0xe1c 0xdf9 0xdd6 0xdf4 0xe07 0xe55 0xe47 0xe51 0xe41 0xe4d 0xe46 0xdef 0xe00 0xdf9 0xe2c 0xe2b 0xe20 0xe23 0xe09 0xde5 0xded 0xdeb 0xdfb 0xe6d 0xe64 0xe72 0xe60 0xe6b 0xe6e 0xe46 0xe2e 0xe25 0xe60 0xe70 0xe70 0xe6d 0xe58 0xe3a 0xe47 0xe43 0xe56 0xe98 0xe89 0xe97 0xe7c 0xe91 0xe98 0xe67 0xe54 0xe4a 0xe38 0xe40 0xe44 0xe3a 0xe25 0xe08 0xe0f 0xe0c 0xe24 0xe6d 0xe5c 0xe69 0xe54 0xe66 0xe6a 0xe40 0xe2a 0xe21 0xe4a 0xe51 0xe5b 0xe4e 0xe39 0xdf4 0xe2c 0xe25 0xe39 0xe78 0xe6a 0xe70 0xe60 0xe6a 0xe54 0xe59 0xe4b 0xe39 0xe64 0xe66 0xe77 0xe6b 0xe54 0xe39 0xe4f 0xe46 0xe59 0xe66 0xe59 0xe5d 0xe4e 0xe58 0xe78 0xe5c 0xe4e 0xe38 0xe6b 0xe75 0xe83 0xe7b 0xe5f 0xe4a 0xe5f 0xe5f 0xe71 0xe82 0xe72 0xe7f 0xe6e 0xe7c 0xe98 0xe90 0xe79 0xe67 0xe5c 0xe66 0xe70 0xe6e 0xe3f 0xe41 0xe54 0xe55 0xe69 0xe6d 0xe62 0xe6e 0xe5c 0xe54 0xe8d 0xe83 0xe6d 0xe5c 0xe80 0xe90 0xea6 0xebe 0xe90 0xea2 0xeb0 0xead 0xebb 0xe94 0xe80 0xe87 0xe71 0xe6d 0xea5 0xeb0 0xea3 0xe94 0xe70 0xe7b 0xe8e 0xea3 0xe93 0xe8e 0xe93 0xe98 0xea9 0xe67 0xe4f 0xe54 0xe43 0xe5f 0xe86 0xe97 0xe8c 0xe7e 0xe69 0xe6e 0xe85 0xea1 0xe95 0xe87 0xe8e 0xe8e 0xea3 0xe6b 0xe56 0xe4e 0xe43 0xe52 0xe71 0xe7e 0xe7e 0xe67 0xe85 0xe86 0xea1 0xe9c 0xeb6 0xea9 0xeaf 0xeaf 0xec6 0xe6a 0xe52 0xe4e 0xe2c 0xe6a 0xe94 0xea3 0xea3 0xe8d 0xe77 0xe7f 0xe90 0xeb8 0xeb4 0xeaa 0xea9 0xeb0 0xec2 0xe40 0xe27 0xe24 0xe2a 0xe46 0xe6d 0xe7c 0xe80 0xe6d 0xe6d 0xe74 0xe85 0xeb3 0xeb3 0xea9 0xea5 0xeaf 0xeba 0xe4d 0xe36 0xe33 0xe44 0xe5c 0xe80 0xe95 0xe97 0xe89 0xe9b 0xea9 0xec2 0xef2 0xefc 0xef2 0xeec 0xef2 0xf00 0xe66 0xe4f 0xe48 0xe54 0xe79 0xe9e 0xea9 0xeb8 0xea5 0xe5c 0xe67 0xe64 0xea9 0xeba 0xeb1 0xea5 0xea5 0xeb7 0xe40 0xe28 0xe0e 0xe3a 0xe5c 0xe78 0xe86 0xe9b 0xe80 0xe77 0xe7e 0xe9c 0xec8 0xed9 0xec9 0xec6 0xec2 0xed9 0xe2e 0xe12 0xe13 0xe2b 0xe44 0xe66 0xe78 0xe8c 0xe7b 0xe62 0xe64 0xe89 0xeb6 0xec8 0xeb8 0xeb3 0xeaf 0xecb 0xe38 0xe1a 0xe1e 0xe3a 0xe52 0xe74 0xe82 0xe9a 0xe86 0xe56 0xe4b 0xe87 0xebb 0xecf 0xec2 0xeb7 0xec1 0xecf 0xe15 0xde1 0xe02 0xe15 0xe32 0xe56 0xe69 0xe74 0xe6e 0xe48 0xe54 0xe71 0xea3 0xebb 0xeb1 0xea5 0xea9 0xeb3 0xe00 0xdec 0xe00 0xe13 0xe33 0xe54 0xe67 0xe71 0xe78 0xe83 0xe97 0xebf 0xeef 0xf13 0xf0b 0xefa 0xefd 0xf0a 0xe27 0xe19 0xe28 0xe3c 0xe5c 0xe7e 0xe87 0xe98 0xe9b 0xe3c 0xe51 0xe79 0xe9e 0xec2 0xebb 0xeb0 0xeb1 0xec4 0xded 0xdde 0xdf2 0xe02 0xe2a 0xe4a 0xe56 0xe67 0xe72 0xe23 0xe52 0xe78 0xea1 0xec8 0xec1 0xeb7 0xeac 0xebe 0xdc9 0xdd3 0xde4 0xdfd 0xe15 0xe38 0xe4d 0xe5c 0xe6a 0xd82 0xe3a 0xe5d 0xe83 0xeb1 0xea6 0xea2 0xe9c 0xea8 0xdd3 0xdd3 0xddf 0xdf7 0xe09 0xe27 0xe3d 0xe51 0xda7 0xd7f 0xe47 0xe5d 0xe8c 0xeba 0xeb1 0xead 0xead 0xeb3 0xdc1 0xdbf 0xdd3 0xddf 0xdf3 0xe17 0xe2e 0xe43 0xd9f 0xd64 0xe32 0xe52 0xe82 0xeaf 0xea9 0xeac 0xeaa 0xeaa 0xdc6 0xdc8 0xde1 0xde8 0xdfb 0xe1d 0xe33 0xe3d 0xd9c 0x1400 0x1400 0x1400>;
					PS_Config_Lmt_Open_Rawdata_N = <0x55e 0x5b3 0x5b6 0x5b6 0x5af 0x5a5 0x5a5 0x59b 0x525 0x57d 0x605 0x60c 0x603 0x60a 0x5ed 0x5d4 0x5b9 0x532 0x567 0x5b8 0x5b5 0x5b5 0x5ad 0x5a2 0x5a0 0x597 0x528 0x578 0x5f5 0x5fb 0x5f2 0x5fd 0x5e2 0x5cd 0x5b6 0x552 0x5bf 0x5c9 0x5c7 0x5c5 0x5be 0x5b1 0x5b1 0x5a7 0x5a1 0x600 0x5fd 0x5ff 0x5fb 0x603 0x5ec 0x5d5 0x5c2 0x59d 0x5d2 0x5d4 0x5d3 0x5d0 0x5c7 0x5bb 0x5bc 0x5b0 0x59e 0x601 0x5fe 0x601 0x5fb 0x603 0x5ef 0x5d7 0x5c6 0x599 0x5e4 0x5e3 0x5df 0x5dd 0x5d7 0x5c9 0x5ca 0x5bc 0x5bd 0x60b 0x607 0x60c 0x609 0x610 0x5fb 0x5ea 0x5d6 0x5c5 0x5fa 0x5f2 0x5ec 0x5ed 0x5e4 0x5d4 0x5d6 0x5ca 0x5c9 0x609 0x606 0x60d 0x609 0x60e 0x5fe 0x5eb 0x5d6 0x5cd 0x5fb 0x5f8 0x5f3 0x5f3 0x5eb 0x5dd 0x5dc 0x5d0 0x5d2 0x612 0x60f 0x616 0x60d 0x619 0x60c 0x5f5 0x5e1 0x5e0 0x601 0x601 0x5fb 0x5fa 0x5f1 0x5e6 0x5e3 0x5cb 0x5df 0x612 0x60d 0x615 0x60c 0x616 0x607 0x5f2 0x5cf 0x5dc 0x607 0x606 0x604 0x600 0x5f8 0x5e9 0x5ea 0x5e2 0x5e8 0x612 0x611 0x613 0x60e 0x616 0x611 0x5fa 0x5ec 0x5e6 0x60f 0x60d 0x60c 0x606 0x5ff 0x5f1 0x5f2 0x5ed 0x5f6 0x622 0x61e 0x61f 0x61a 0x61f 0x616 0x5ff 0x5f5 0x5f0 0x617 0x61b 0x615 0x615 0x60c 0x5fd 0x5ee 0x5fb 0x603 0x624 0x61e 0x622 0x61c 0x621 0x61e 0x5f8 0x600 0x5fd 0x613 0x612 0x60d 0x60f 0x604 0x5f4 0x5f8 0x5f7 0x5fe 0x62e 0x62b 0x631 0x629 0x62e 0x62f 0x61e 0x613 0x610 0x629 0x630 0x630 0x62e 0x625 0x619 0x61e 0x61c 0x625 0x641 0x63a 0x640 0x635 0x63e 0x641 0x62c 0x624 0x61f 0x618 0x61b 0x61d 0x619 0x610 0x603 0x606 0x605 0x60f 0x62e 0x627 0x62d 0x624 0x62b 0x62d 0x61b 0x612 0x60e 0x61f 0x622 0x627 0x621 0x618 0x5fb 0x613 0x610 0x618 0x633 0x62d 0x630 0x629 0x62d 0x624 0x626 0x620 0x618 0x62b 0x62b 0x633 0x62e 0x624 0x618 0x622 0x61e 0x626 0x62b 0x626 0x628 0x621 0x625 0x633 0x627 0x621 0x618 0x62e 0x632 0x638 0x634 0x628 0x61f 0x628 0x628 0x630 0x637 0x631 0x636 0x62f 0x635 0x641 0x63d 0x634 0x62c 0x627 0x62b 0x630 0x62f 0x61b 0x61c 0x624 0x624 0x62d 0x62e 0x62a 0x62f 0x627 0x624 0x63c 0x638 0x62e 0x627 0x637 0x63d 0x647 0x651 0x63d 0x645 0x64b 0x64a 0x650 0x63f 0x637 0x63a 0x630 0x62e 0x646 0x64b 0x646 0x63f 0x630 0x634 0x63d 0x646 0x63f 0x63d 0x63f 0x641 0x648 0x62c 0x622 0x624 0x61c 0x628 0x639 0x640 0x63c 0x636 0x62d 0x62f 0x639 0x645 0x640 0x63a 0x63d 0x63d 0x646 0x62e 0x625 0x621 0x61c 0x623 0x630 0x636 0x636 0x62c 0x639 0x639 0x645 0x643 0x64e 0x648 0x64b 0x64b 0x655 0x62d 0x623 0x621 0x613 0x62d 0x63f 0x646 0x646 0x63c 0x633 0x636 0x63d 0x64f 0x64d 0x649 0x648 0x64b 0x653 0x61b 0x610 0x60f 0x612 0x61e 0x62e 0x635 0x637 0x62e 0x62e 0x631 0x639 0x64c 0x64c 0x648 0x646 0x64b 0x64f 0x621 0x617 0x616 0x61d 0x627 0x637 0x640 0x640 0x63a 0x642 0x648 0x653 0x667 0x66c 0x667 0x665 0x667 0x66d 0x62b 0x622 0x61f 0x624 0x634 0x643 0x648 0x64f 0x646 0x627 0x62c 0x62b 0x648 0x64f 0x64c 0x646 0x646 0x64e 0x61b 0x611 0x606 0x619 0x627 0x633 0x639 0x642 0x637 0x633 0x636 0x643 0x655 0x65d 0x656 0x655 0x653 0x65d 0x613 0x607 0x608 0x612 0x61d 0x62b 0x633 0x63c 0x634 0x62a 0x62b 0x63a 0x64e 0x655 0x64f 0x64c 0x64b 0x657 0x618 0x60b 0x60d 0x619 0x623 0x631 0x637 0x642 0x639 0x625 0x620 0x63a 0x650 0x658 0x653 0x64e 0x652 0x658 0x609 0x5f2 0x601 0x609 0x615 0x625 0x62d 0x631 0x62f 0x61f 0x624 0x630 0x646 0x650 0x64c 0x646 0x648 0x64c 0x600 0x5f7 0x600 0x608 0x616 0x624 0x62c 0x630 0x633 0x638 0x640 0x652 0x666 0x676 0x672 0x66b 0x66c 0x672 0x610 0x60a 0x611 0x619 0x627 0x636 0x63a 0x641 0x642 0x619 0x622 0x634 0x643 0x653 0x650 0x64b 0x64c 0x654 0x5f8 0x5f1 0x5fa 0x601 0x612 0x61f 0x625 0x62c 0x631 0x60f 0x623 0x633 0x645 0x655 0x652 0x64e 0x649 0x651 0x5e8 0x5ec 0x5f4 0x5fe 0x609 0x618 0x621 0x627 0x62d 0x5ca 0x619 0x628 0x638 0x64c 0x647 0x645 0x643 0x648 0x5ec 0x5ec 0x5f2 0x5fc 0x604 0x610 0x61a 0x622 0x5da 0x5c8 0x61e 0x628 0x63c 0x64f 0x64c 0x64a 0x64a 0x64c 0x5e5 0x5e4 0x5ec 0x5f2 0x5fa 0x60a 0x613 0x61c 0x5d6 0x5bd 0x615 0x623 0x637 0x64b 0x648 0x649 0x649 0x649 0x5e7 0x5e8 0x5f2 0x5f5 0x5fe 0x60c 0x616 0x61a 0x5d5 0xfffffe01 0xfffffe01 0xfffffe01>;
					PS_Config_Lmt_FW_Rawdata_P = <0x421 0x444 0x48e 0x456 0x481 0x417 0x430 0x42c 0x431 0x44c 0x448 0x450 0x453 0x45b 0x44c 0x467 0x462 0x450 0x434 0x472 0x484 0x46b 0x485 0x430 0x459 0x441 0x431 0x45a 0x444 0x43b 0x444 0x46e 0x462 0x47c 0x47c 0x43e 0x485 0x473 0x46c 0x47e 0x46f 0x477 0x47a 0x483 0x487 0x423 0x46e 0x48b 0x484 0x481 0x483 0x47d 0x485 0x434 0x42d 0x473 0x47c 0x472 0x481 0x473 0x472 0x441 0x438 0x41c 0x41e 0x44c 0x460 0x467 0x43d 0x483 0x479 0x422 0x438 0x479 0x47a 0x472 0x476 0x477 0x464 0x446 0x43a 0x44b 0x43d 0x43f 0x444 0x446 0x441 0x473 0x473 0x441 0x44c 0x45e 0x464 0x448 0x462 0x44d 0x43f 0x44b 0x465 0x45e 0x44d 0x44f 0x44d 0x44f 0x44c 0x461 0x448 0x44f 0x464 0x47e 0x47e 0x473 0x480 0x473 0x470 0x441 0x465 0x483 0x457 0x473 0x48e 0x49c 0x473 0x492 0x48e 0x448 0x434 0x453 0x495 0x441 0x492 0x44f 0x42c 0x40e 0x4b9 0x48b 0x446 0x43f 0x43d 0x43b 0x441 0x446 0x445 0x43f 0x468 0x448 0x43a 0x438 0x43e 0x437 0x43b 0x44f 0x48b 0x4ad 0x429 0x426 0x430 0x446 0x42d 0x47d 0x483 0x429 0x464 0x444 0x44f 0x434 0x442 0x438 0x43d 0x453 0x47d 0x46e 0x452 0x461 0x45e 0x469 0x44f 0x472 0x472 0x446 0x444 0x444 0x44d 0x445 0x444 0x44b 0x452 0x446 0x465 0x479 0x454 0x44b 0x44d 0x453 0x453 0x45d 0x464 0x44b 0x44b 0x470 0x46f 0x469 0x462 0x464 0x45b 0x449 0x46e 0x493 0x44c 0x43f 0x437 0x43e 0x433 0x42d 0x42d 0x429 0x43a 0x450 0x44d 0x44b 0x454 0x449 0x445 0x442 0x46e 0x46c 0x45b 0x462 0x461 0x45e 0x460 0x45b 0x457 0x467 0x445 0x421 0x42a 0x434 0x436 0x43f 0x43d 0x430 0x498 0x464 0x43d 0x437 0x436 0x444 0x446 0x459 0x459 0x441 0x460 0x45e 0x45e 0x45a 0x454 0x457 0x453 0x452 0x473 0x48a 0x428 0x425 0x430 0x42f 0x446 0x45e 0x475 0x43a 0x452 0x442 0x448 0x444 0x441 0x445 0x446 0x44b 0x44d 0x477 0x449 0x43f 0x448 0x449 0x43f 0x442 0x450 0x43b 0x429 0x464 0x45a 0x457 0x459 0x433 0x429 0x42c 0x496 0x4a1 0x442 0x445 0x43d 0x441 0x44b 0x454 0x448 0x43a 0x431 0x46e 0x46e 0x454 0x456 0x436 0x42c 0x43e 0x480 0x481 0x44f 0x452 0x450 0x431 0x442 0x438 0x438 0x44d 0x46b 0x48c 0x49a 0x488 0x498 0x475 0x472 0x45e 0x47e 0x48e 0x449 0x444 0x448 0x449 0x44b 0x461 0x461 0x43f 0x454 0x45b 0x45b 0x461 0x45a 0x45b 0x459 0x45d 0x450 0x485 0x44c 0x445 0x448 0x442 0x442 0x44b 0x43f 0x454 0x450 0x46b 0x449 0x453 0x44b 0x453 0x452 0x452 0x484 0x43f 0x457 0x43d 0x436 0x44f 0x43f 0x448 0x454 0x450 0x446 0x433 0x441 0x441 0x444 0x449 0x450 0x460 0x496 0x484 0x43e 0x441 0x457 0x475 0x465 0x45d 0x483 0x41c 0x467 0x450 0x44c 0x456 0x452 0x44d 0x44f 0x44c 0x45a 0x483 0x42c 0x468 0x465 0x468 0x468 0x467 0x47a 0x437 0x450 0x43e 0x426 0x429 0x42a 0x437 0x430 0x444 0x4a8 0x472 0x473 0x469 0x46e 0x45e 0x457 0x450 0x44d 0x445 0x445 0x457 0x454 0x452 0x449 0x444 0x444 0x442 0x464 0x499 0x43f 0x43d 0x43a 0x43f 0x43e 0x43e 0x437 0x433 0x43a 0x448 0x436 0x43a 0x436 0x43a 0x433 0x43e 0x4ae 0x48e 0x437 0x43a 0x430 0x445 0x42d 0x429 0x449 0x423 0x457 0x479 0x483 0x48c 0x48b 0x484 0x47e 0x48b 0x452 0x4a4 0x436 0x437 0x436 0x450 0x456 0x457 0x469 0x431 0x426 0x436 0x445 0x442 0x43e 0x426 0x423 0x43e 0x4ad 0x470 0x477 0x476 0x472 0x47d 0x47c 0x473 0x46f 0x45b 0x43b 0x452 0x452 0x44f 0x44c 0x44c 0x442 0x43f 0x484 0x4a7 0x441 0x42f 0x426 0x438 0x42f 0x423 0x425 0x441 0x43e 0x459 0x453 0x460 0x45a 0x45b 0x44b 0x437 0x48c 0x48c 0x444 0x44b 0x446 0x457 0x462 0x457 0x464 0x45b 0x456 0x45b 0x452 0x44d 0x453 0x44d 0x452 0x453 0x47a 0x48c 0x43d 0x446 0x456 0x461 0x460 0x45e 0x468 0x459 0x43e 0x47a 0x452 0x45b 0x457 0x446 0x445 0x437 0x48e 0x47c 0x450 0x44b 0x460 0x457 0x45a 0x45e 0x454 0x453 0x43b 0x473 0x47c 0x476 0x472 0x47a 0x452 0x44c 0x484 0x48b 0x43e 0x44d 0x465 0x465 0x467 0x45e 0x477 0x44f 0x44d 0x479 0x45d 0x45e 0x45a 0x459 0x431 0x436 0x475 0x485 0x44c 0x45e 0x475 0x476 0x47e 0x47c 0x46c 0x484 0x479 0x46c 0x473 0x479 0x46b 0x483 0x457 0x449 0x485 0x46e 0x44b 0x43e 0x46b 0x462 0x47a 0x472 0x46e 0x480 0x459 0x456 0x445 0x444 0x43f 0x445 0x45d 0x473 0x445 0x40e 0x431 0x445 0x41a 0x428 0x423 0x413 0x446 0x487 0xf00 0xf00 0xf00>;
					PS_Config_Lmt_FW_Rawdata_N = <0x1c5 0x1d4 0x1f3 0x1db 0x1ee 0x1c0 0x1cb 0x1c9 0x1cc 0x1d7 0x1d5 0x1d9 0x1da 0x1de 0x1d7 0x1e3 0x1e1 0x1d9 0x1cd 0x1e7 0x1ef 0x1e4 0x1f0 0x1cb 0x1dd 0x1d2 0x1cc 0x1dd 0x1d4 0x1d0 0x1d4 0x1e6 0x1e1 0x1ec 0x1ec 0x1d1 0x1f0 0x1e8 0x1e5 0x1ed 0x1e6 0x1ea 0x1eb 0x1ef 0x1f0 0x1c6 0x1e6 0x1f2 0x1ef 0x1ee 0x1ef 0x1ec 0x1f0 0x1cd 0x1ca 0x1e8 0x1ec 0x1e7 0x1ee 0x1e8 0x1e7 0x1d2 0x1cf 0x1c3 0x1c3 0x1d7 0x1e0 0x1e3 0x1d1 0x1ef 0x1ea 0x1c5 0x1cf 0x1ea 0x1eb 0x1e7 0x1e9 0x1ea 0x1e1 0x1d5 0x1cf 0x1d7 0x1d1 0x1d2 0x1d4 0x1d5 0x1d2 0x1e8 0x1e8 0x1d2 0x1d7 0x1df 0x1e1 0x1d5 0x1e1 0x1d8 0x1d2 0x1d7 0x1e2 0x1df 0x1d8 0x1d8 0x1d8 0x1d8 0x1d7 0x1e0 0x1d5 0x1d8 0x1e1 0x1ed 0x1ed 0x1e8 0x1ed 0x1e8 0x1e7 0x1d2 0x1e2 0x1ef 0x1dc 0x1e8 0x1f3 0x1f9 0x1e8 0x1f5 0x1f3 0x1d5 0x1cd 0x1da 0x1f6 0x1d2 0x1f5 0x1d8 0x1c9 0x1bd 0x206 0x1f2 0x1d5 0x1d2 0x1d1 0x1d0 0x1d2 0x1d5 0x1d4 0x1d2 0x1e3 0x1d5 0x1cf 0x1cf 0x1d1 0x1ce 0x1d0 0x1d8 0x1f2 0x201 0x1c8 0x1c7 0x1cb 0x1d5 0x1ca 0x1ec 0x1ef 0x1c8 0x1e1 0x1d4 0x1d8 0x1cd 0x1d3 0x1cf 0x1d1 0x1da 0x1ec 0x1e6 0x1da 0x1e0 0x1df 0x1e4 0x1d8 0x1e7 0x1e7 0x1d5 0x1d4 0x1d4 0x1d8 0x1d4 0x1d4 0x1d7 0x1da 0x1d5 0x1e2 0x1ea 0x1db 0x1d7 0x1d8 0x1da 0x1da 0x1de 0x1e1 0x1d7 0x1d7 0x1e7 0x1e6 0x1e4 0x1e1 0x1e1 0x1de 0x1d6 0x1e6 0x1f6 0x1d7 0x1d2 0x1ce 0x1d1 0x1cc 0x1ca 0x1ca 0x1c8 0x1cf 0x1d9 0x1d8 0x1d7 0x1db 0x1d6 0x1d4 0x1d3 0x1e6 0x1e5 0x1de 0x1e1 0x1e0 0x1df 0x1e0 0x1de 0x1dc 0x1e3 0x1d4 0x1c5 0x1c9 0x1cd 0x1ce 0x1d2 0x1d1 0x1cb 0x1f8 0x1e1 0x1d1 0x1ce 0x1ce 0x1d4 0x1d5 0x1dd 0x1dd 0x1d2 0x1e0 0x1df 0x1df 0x1dd 0x1db 0x1dc 0x1da 0x1da 0x1e8 0x1f2 0x1c8 0x1c6 0x1cb 0x1cb 0x1d5 0x1df 0x1e9 0x1cf 0x1da 0x1d3 0x1d5 0x1d4 0x1d2 0x1d4 0x1d5 0x1d7 0x1d8 0x1ea 0x1d6 0x1d2 0x1d5 0x1d6 0x1d2 0x1d3 0x1d9 0x1d0 0x1c8 0x1e1 0x1dd 0x1dc 0x1dd 0x1cc 0x1c8 0x1c9 0x1f7 0x1fc 0x1d3 0x1d4 0x1d1 0x1d2 0x1d7 0x1db 0x1d5 0x1cf 0x1cc 0x1e6 0x1e6 0x1db 0x1db 0x1ce 0x1c9 0x1d1 0x1ed 0x1ee 0x1d8 0x1da 0x1d9 0x1cc 0x1d3 0x1cf 0x1cf 0x1d8 0x1e4 0x1f3 0x1f9 0x1f1 0x1f8 0x1e9 0x1e7 0x1df 0x1ed 0x1f3 0x1d6 0x1d4 0x1d5 0x1d6 0x1d7 0x1e0 0x1e0 0x1d2 0x1db 0x1de 0x1de 0x1e0 0x1dd 0x1de 0x1dd 0x1de 0x1d9 0x1f0 0x1d7 0x1d4 0x1d5 0x1d3 0x1d3 0x1d7 0x1d2 0x1db 0x1d9 0x1e4 0x1d6 0x1da 0x1d7 0x1da 0x1da 0x1da 0x1ef 0x1d2 0x1dc 0x1d1 0x1ce 0x1d8 0x1d2 0x1d5 0x1db 0x1d9 0x1d5 0x1cc 0x1d2 0x1d2 0x1d4 0x1d6 0x1d9 0x1e0 0x1f7 0x1ef 0x1d1 0x1d2 0x1dc 0x1e9 0x1e2 0x1de 0x1ef 0x1c3 0x1e3 0x1d9 0x1d7 0x1db 0x1da 0x1d8 0x1d8 0x1d7 0x1dd 0x1ef 0x1c9 0x1e3 0x1e2 0x1e3 0x1e3 0x1e3 0x1eb 0x1ce 0x1d9 0x1d1 0x1c7 0x1c8 0x1c9 0x1ce 0x1cb 0x1d4 0x1ff 0x1e7 0x1e8 0x1e4 0x1e6 0x1df 0x1dc 0x1d9 0x1d8 0x1d4 0x1d4 0x1dc 0x1db 0x1da 0x1d6 0x1d4 0x1d4 0x1d3 0x1e1 0x1f8 0x1d2 0x1d1 0x1cf 0x1d2 0x1d1 0x1d1 0x1ce 0x1cc 0x1cf 0x1d5 0x1ce 0x1cf 0x1ce 0x1cf 0x1cc 0x1d1 0x201 0x1f3 0x1ce 0x1cf 0x1cb 0x1d4 0x1ca 0x1c8 0x1d6 0x1c6 0x1dc 0x1ea 0x1ef 0x1f3 0x1f2 0x1ef 0x1ed 0x1f2 0x1da 0x1fd 0x1ce 0x1ce 0x1ce 0x1d9 0x1db 0x1dc 0x1e4 0x1cc 0x1c7 0x1ce 0x1d4 0x1d3 0x1d1 0x1c7 0x1c6 0x1d1 0x201 0x1e7 0x1ea 0x1e9 0x1e7 0x1ec 0x1ec 0x1e8 0x1e6 0x1de 0x1d0 0x1da 0x1da 0x1d8 0x1d7 0x1d7 0x1d3 0x1d2 0x1ef 0x1fe 0x1d2 0x1cb 0x1c7 0x1cf 0x1cb 0x1c6 0x1c6 0x1d2 0x1d1 0x1dd 0x1da 0x1e0 0x1dd 0x1de 0x1d7 0x1ce 0x1f3 0x1f3 0x1d4 0x1d7 0x1d5 0x1dc 0x1e1 0x1dc 0x1e1 0x1de 0x1db 0x1de 0x1da 0x1d8 0x1da 0x1d8 0x1da 0x1da 0x1eb 0x1f3 0x1d1 0x1d5 0x1db 0x1e0 0x1e0 0x1df 0x1e3 0x1dd 0x1d1 0x1eb 0x1da 0x1de 0x1dc 0x1d5 0x1d4 0x1ce 0x1f3 0x1ec 0x1d9 0x1d7 0x1e0 0x1dc 0x1dd 0x1df 0x1db 0x1da 0x1d0 0x1e8 0x1ec 0x1e9 0x1e7 0x1eb 0x1da 0x1d7 0x1ef 0x1f2 0x1d1 0x1d8 0x1e2 0x1e2 0x1e3 0x1df 0x1ea 0x1d8 0x1d8 0x1ea 0x1de 0x1df 0x1dd 0x1dd 0x1cc 0x1ce 0x1e9 0x1f0 0x1d7 0x1df 0x1e9 0x1e9 0x1ed 0x1ec 0x1e5 0x1ef 0x1ea 0x1e5 0x1e8 0x1ea 0x1e4 0x1ef 0x1dc 0x1d6 0x1f0 0x1e6 0x1d7 0x1d1 0x1e4 0x1e1 0x1eb 0x1e7 0x1e6 0x1ed 0x1dd 0x1db 0x1d4 0x1d4 0x1d2 0x1d4 0x1de 0x1e8 0x1d4 0x1bd 0x1cc 0x1d4 0x1c2 0x1c8 0x1c6 0x1bf 0x1d5 0x1f0 0xf0 0xf0 0xf0>;
					PS_Config_Lmt_FW_CC_P = <0x2c 0x29 0x29 0x29 0x29 0x2c 0x2a 0x2a 0x2a 0x2c 0x2c 0x2c 0x2c 0x2a 0x2a 0x29 0x29 0x2c 0x2c 0x29 0x29 0x29 0x29 0x2a 0x29 0x29 0x2a 0x29 0x29 0x2a 0x2a 0x29 0x29 0x29 0x29 0x29 0x29 0x29 0x29 0x29 0x29 0x29 0x29 0x29 0x29 0x2c 0x29 0x29 0x29 0x29 0x29 0x29 0x29 0x2a 0x2c 0x29 0x29 0x29 0x29 0x29 0x29 0x2a 0x2c 0x2c 0x2a 0x2a 0x29 0x29 0x29 0x29 0x29 0x2a 0x2a 0x29 0x29 0x29 0x29 0x29 0x29 0x29 0x29 0x2c 0x2a 0x2a 0x2a 0x29 0x2a 0x29 0x29 0x2c 0x2c 0x29 0x29 0x2a 0x29 0x29 0x2a 0x2a 0x2c 0x2a 0x2a 0x2a 0x29 0x29 0x2a 0x29 0x29 0x2a 0x2a 0x29 0x29 0x29 0x29 0x29 0x29 0x2a 0x2c 0x2c 0x2a 0x29 0x29 0x29 0x29 0x29 0x29 0x2a 0x2c 0x2a 0x29 0x2a 0x29 0x29 0x2a 0x2c 0x2c 0x2c 0x2a 0x2a 0x2a 0x2a 0x2a 0x29 0x29 0x2a 0x2a 0x29 0x29 0x29 0x29 0x29 0x2a 0x2a 0x2c 0x2c 0x2c 0x2a 0x2a 0x29 0x2a 0x29 0x29 0x2c 0x2c 0x2a 0x2a 0x2c 0x2a 0x2c 0x2c 0x2c 0x2c 0x2c 0x2a 0x2a 0x2a 0x29 0x2a 0x29 0x29 0x2a 0x2a 0x2a 0x29 0x2a 0x2a 0x2a 0x2a 0x2a 0x2c 0x2c 0x2a 0x2a 0x2a 0x2a 0x2a 0x29 0x29 0x2a 0x2c 0x29 0x29 0x29 0x29 0x29 0x2a 0x2a 0x2c 0x2c 0x2c 0x2c 0x2c 0x2a 0x2c 0x2a 0x2a 0x2c 0x2a 0x29 0x29 0x29 0x29 0x2a 0x2a 0x2a 0x2c 0x2c 0x2a 0x2a 0x2a 0x2a 0x2a 0x2a 0x29 0x2a 0x2c 0x2a 0x2a 0x2a 0x2a 0x2a 0x2a 0x2c 0x2c 0x2c 0x2a 0x2a 0x2a 0x2a 0x2a 0x29 0x29 0x2a 0x2a 0x29 0x29 0x29 0x29 0x29 0x29 0x2a 0x2c 0x2c 0x2c 0x2a 0x2a 0x2a 0x2a 0x29 0x29 0x2c 0x2c 0x2a 0x2a 0x2a 0x2a 0x2a 0x2a 0x2c 0x2c 0x2c 0x2c 0x2a 0x2a 0x2a 0x2a 0x2a 0x29 0x2a 0x2a 0x29 0x29 0x29 0x29 0x2a 0x2a 0x2a 0x2c 0x2c 0x2c 0x2a 0x2a 0x2a 0x2a 0x2a 0x2a 0x2c 0x2c 0x29 0x2a 0x2a 0x2a 0x2a 0x2c 0x2c 0x2c 0x2c 0x2c 0x2a 0x2a 0x2a 0x2a 0x2a 0x2a 0x2a 0x29 0x29 0x29 0x29 0x29 0x29 0x29 0x29 0x2c 0x2c 0x2c 0x2a 0x2a 0x2a 0x2a 0x29 0x29 0x2c 0x2c 0x2a 0x2a 0x2a 0x2a 0x2a 0x2a 0x2c 0x2d 0x2c 0x2c 0x2a 0x2a 0x2a 0x2a 0x2a 0x2a 0x2c 0x2a 0x29 0x29 0x29 0x29 0x29 0x2a 0x2a 0x2c 0x2d 0x2c 0x2a 0x2a 0x2a 0x2a 0x2a 0x29 0x2c 0x2c 0x2a 0x2a 0x2a 0x2a 0x2c 0x2c 0x2c 0x2c 0x2c 0x2a 0x2a 0x2a 0x29 0x29 0x29 0x29 0x2c 0x2a 0x29 0x29 0x29 0x29 0x2a 0x2a 0x2a 0x2c 0x2c 0x2c 0x2a 0x29 0x29 0x29 0x29 0x29 0x2a 0x2c 0x2a 0x2a 0x2a 0x2a 0x2c 0x2c 0x2c 0x2c 0x2c 0x2a 0x2a 0x2a 0x29 0x2a 0x2a 0x29 0x2c 0x2a 0x29 0x29 0x29 0x29 0x2a 0x2a 0x2a 0x2c 0x2c 0x2a 0x2a 0x2a 0x29 0x29 0x29 0x29 0x2c 0x2c 0x2a 0x2c 0x2a 0x2a 0x2a 0x2a 0x2c 0x2c 0x2c 0x2a 0x2a 0x2a 0x2a 0x2a 0x2a 0x2a 0x2c 0x2a 0x29 0x29 0x29 0x29 0x29 0x29 0x29 0x2c 0x2c 0x2c 0x2a 0x2a 0x2a 0x29 0x2a 0x29 0x2c 0x2c 0x2a 0x2a 0x2a 0x2a 0x2a 0x2c 0x2c 0x2c 0x2c 0x2a 0x2a 0x2a 0x29 0x29 0x2a 0x29 0x2a 0x2a 0x29 0x29 0x29 0x29 0x2a 0x2a 0x2a 0x2c 0x2c 0x2c 0x2a 0x2a 0x2a 0x2a 0x2a 0x2a 0x2a 0x2c 0x29 0x2a 0x29 0x29 0x2a 0x2a 0x2c 0x2c 0x2c 0x2a 0x2a 0x2a 0x29 0x29 0x2a 0x29 0x2a 0x2a 0x29 0x29 0x29 0x29 0x29 0x2a 0x2a 0x2c 0x2c 0x2c 0x2a 0x29 0x29 0x29 0x29 0x29 0x2a 0x2c 0x29 0x2a 0x2a 0x2a 0x2a 0x2a 0x2c 0x2c 0x2c 0x2a 0x2a 0x29 0x29 0x29 0x29 0x29 0x2a 0x2a 0x29 0x29 0x29 0x29 0x29 0x29 0x29 0x2c 0x2c 0x2a 0x2a 0x29 0x29 0x29 0x29 0x29 0x2a 0x2a 0x29 0x2a 0x29 0x2a 0x2a 0x2c 0x2c 0x2c 0x2c 0x2a 0x2a 0x29 0x29 0x29 0x29 0x29 0x29 0x29 0x29 0x29 0x29 0x29 0x29 0x2a 0x2a 0x2c 0x2c 0x2c 0x2a 0x29 0x29 0x29 0x29 0x29 0x29 0x29 0x2a 0x2c 0x2a 0x2c 0x2c 0x2c 0x2c 0x2e 0x2e 0x2c 0x2c 0x2c 0x2c 0x2a 0x2c 0x29 0x29 0x13a 0x13a 0x13a>;
					PS_Config_Lmt_FW_CC_N = <0x13 0x12 0x12 0x12 0x12 0x13 0x13 0x13 0x13 0x13 0x13 0x13 0x13 0x13 0x13 0x12 0x12 0x13 0x13 0x12 0x12 0x12 0x12 0x13 0x12 0x12 0x13 0x12 0x12 0x13 0x13 0x12 0x12 0x12 0x12 0x12 0x12 0x12 0x12 0x12 0x12 0x12 0x12 0x12 0x12 0x13 0x12 0x12 0x12 0x12 0x12 0x12 0x12 0x13 0x13 0x12 0x12 0x12 0x12 0x12 0x12 0x13 0x13 0x13 0x13 0x13 0x12 0x12 0x12 0x12 0x12 0x13 0x13 0x12 0x12 0x12 0x12 0x12 0x12 0x12 0x12 0x13 0x13 0x13 0x13 0x12 0x13 0x12 0x12 0x13 0x13 0x12 0x12 0x13 0x12 0x12 0x13 0x13 0x13 0x13 0x13 0x13 0x12 0x12 0x13 0x12 0x12 0x13 0x13 0x12 0x12 0x12 0x12 0x12 0x12 0x13 0x13 0x13 0x13 0x12 0x12 0x12 0x12 0x12 0x12 0x13 0x13 0x13 0x12 0x13 0x12 0x12 0x13 0x13 0x13 0x13 0x13 0x13 0x13 0x13 0x13 0x12 0x12 0x13 0x13 0x12 0x12 0x12 0x12 0x12 0x13 0x13 0x13 0x13 0x13 0x13 0x13 0x12 0x13 0x12 0x12 0x13 0x13 0x13 0x13 0x13 0x13 0x13 0x13 0x13 0x13 0x13 0x13 0x13 0x13 0x12 0x13 0x12 0x12 0x13 0x13 0x13 0x12 0x13 0x13 0x13 0x13 0x13 0x13 0x13 0x13 0x13 0x13 0x13 0x13 0x12 0x12 0x13 0x13 0x12 0x12 0x12 0x12 0x12 0x13 0x13 0x13 0x13 0x13 0x13 0x13 0x13 0x13 0x13 0x13 0x13 0x13 0x12 0x12 0x12 0x12 0x13 0x13 0x13 0x13 0x13 0x13 0x13 0x13 0x13 0x13 0x13 0x12 0x13 0x13 0x13 0x13 0x13 0x13 0x13 0x13 0x13 0x13 0x13 0x13 0x13 0x13 0x13 0x13 0x12 0x12 0x13 0x13 0x12 0x12 0x12 0x12 0x12 0x12 0x13 0x13 0x13 0x13 0x13 0x13 0x13 0x13 0x12 0x12 0x13 0x13 0x13 0x13 0x13 0x13 0x13 0x13 0x13 0x13 0x13 0x13 0x13 0x13 0x13 0x13 0x13 0x12 0x13 0x13 0x12 0x12 0x12 0x12 0x13 0x13 0x13 0x13 0x13 0x13 0x13 0x13 0x13 0x13 0x13 0x13 0x13 0x13 0x12 0x13 0x13 0x13 0x13 0x13 0x13 0x13 0x13 0x13 0x13 0x13 0x13 0x13 0x13 0x13 0x13 0x12 0x12 0x12 0x12 0x12 0x12 0x12 0x12 0x13 0x13 0x13 0x13 0x13 0x13 0x13 0x12 0x12 0x13 0x13 0x13 0x13 0x13 0x13 0x13 0x13 0x13 0x14 0x13 0x13 0x13 0x13 0x13 0x13 0x13 0x13 0x13 0x13 0x12 0x12 0x12 0x12 0x12 0x13 0x13 0x13 0x14 0x13 0x13 0x13 0x13 0x13 0x13 0x12 0x13 0x13 0x13 0x13 0x13 0x13 0x13 0x13 0x13 0x13 0x13 0x13 0x13 0x13 0x12 0x12 0x12 0x12 0x13 0x13 0x12 0x12 0x12 0x12 0x13 0x13 0x13 0x13 0x13 0x13 0x13 0x12 0x12 0x12 0x12 0x12 0x13 0x13 0x13 0x13 0x13 0x13 0x13 0x13 0x13 0x13 0x13 0x13 0x13 0x13 0x12 0x13 0x13 0x12 0x13 0x13 0x12 0x12 0x12 0x12 0x13 0x13 0x13 0x13 0x13 0x13 0x13 0x13 0x12 0x12 0x12 0x12 0x13 0x13 0x13 0x13 0x13 0x13 0x13 0x13 0x13 0x13 0x13 0x13 0x13 0x13 0x13 0x13 0x13 0x13 0x13 0x13 0x12 0x12 0x12 0x12 0x12 0x12 0x12 0x13 0x13 0x13 0x13 0x13 0x13 0x12 0x13 0x12 0x13 0x13 0x13 0x13 0x13 0x13 0x13 0x13 0x13 0x13 0x13 0x13 0x13 0x13 0x12 0x12 0x13 0x12 0x13 0x13 0x12 0x12 0x12 0x12 0x13 0x13 0x13 0x13 0x13 0x13 0x13 0x13 0x13 0x13 0x13 0x13 0x13 0x13 0x12 0x13 0x12 0x12 0x13 0x13 0x13 0x13 0x13 0x13 0x13 0x13 0x12 0x12 0x13 0x12 0x13 0x13 0x12 0x12 0x12 0x12 0x12 0x13 0x13 0x13 0x13 0x13 0x13 0x12 0x12 0x12 0x12 0x12 0x13 0x13 0x12 0x13 0x13 0x13 0x13 0x13 0x13 0x13 0x13 0x13 0x13 0x12 0x12 0x12 0x12 0x12 0x13 0x13 0x12 0x12 0x12 0x12 0x12 0x12 0x12 0x13 0x13 0x13 0x13 0x12 0x12 0x12 0x12 0x12 0x13 0x13 0x12 0x13 0x12 0x13 0x13 0x13 0x13 0x13 0x13 0x13 0x13 0x12 0x12 0x12 0x12 0x12 0x12 0x12 0x12 0x12 0x12 0x12 0x12 0x13 0x13 0x13 0x13 0x13 0x13 0x12 0x12 0x12 0x12 0x12 0x12 0x12 0x13 0x13 0x13 0x13 0x13 0x13 0x13 0x15 0x15 0x13 0x13 0x13 0x13 0x13 0x13 0x12 0x12 0x00 0x00 0x00>;
					PS_Config_Lmt_FW_Diff_P = <0x32 0x32 0x32 0x32 0x32 0x32 0x32 0x32 0x32 0x32 0x32 0x32 0x32 0x32 0x32 0x32 0x32 0x32 0x32 0x32 0x32 0x32 0x32 0x32 0x32 0x32 0x32 0x32 0x32 0x32 0x32 0x32 0x32 0x32 0x32 0x32 0x32 0x32 0x32 0x32 0x32 0x32 0x32 0x32 0x32 0x32 0x32 0x32 0x32 0x32 0x32 0x32 0x32 0x32 0x32 0x32 0x32 0x32 0x32 0x32 0x32 0x32 0x32 0x32 0x32 0x32 0x32 0x32 0x32 0x32 0x32 0x32 0x32 0x32 0x32 0x32 0x32 0x32 0x32 0x32 0x32 0x32 0x32 0x32 0x32 0x32 0x32 0x32 0x32 0x32 0x32 0x32 0x32 0x32 0x32 0x32 0x32 0x32 0x32 0x32 0x32 0x32 0x32 0x32 0x32 0x32 0x32 0x32 0x32 0x32 0x32 0x32 0x32 0x32 0x32 0x32 0x32 0x32 0x32 0x32 0x32 0x32 0x32 0x32 0x32 0x32 0x32 0x32 0x32 0x32 0x32 0x32 0x32 0x32 0x32 0x32 0x32 0x32 0x32 0x32 0x32 0x32 0x32 0x32 0x32 0x32 0x32 0x32 0x32 0x32 0x32 0x32 0x32 0x32 0x32 0x32 0x32 0x32 0x32 0x32 0x32 0x32 0x32 0x32 0x32 0x32 0x32 0x32 0x32 0x32 0x32 0x32 0x32 0x32 0x32 0x32 0x32 0x32 0x32 0x32 0x32 0x32 0x32 0x32 0x32 0x32 0x32 0x32 0x32 0x32 0x32 0x32 0x32 0x32 0x32 0x32 0x32 0x32 0x32 0x32 0x32 0x32 0x32 0x32 0x32 0x32 0x32 0x32 0x32 0x32 0x32 0x32 0x32 0x32 0x32 0x32 0x32 0x32 0x32 0x32 0x32 0x32 0x32 0x32 0x32 0x32 0x32 0x32 0x32 0x32 0x32 0x32 0x32 0x32 0x32 0x32 0x32 0x32 0x32 0x32 0x32 0x32 0x32 0x32 0x32 0x32 0x32 0x32 0x32 0x32 0x32 0x32 0x32 0x32 0x32 0x32 0x32 0x32 0x32 0x32 0x32 0x32 0x32 0x32 0x32 0x32 0x32 0x32 0x32 0x32 0x32 0x32 0x32 0x32 0x32 0x32 0x32 0x32 0x32 0x32 0x32 0x32 0x32 0x32 0x32 0x32 0x32 0x32 0x32 0x32 0x32 0x32 0x32 0x32 0x32 0x32 0x32 0x32 0x32 0x32 0x32 0x32 0x32 0x32 0x32 0x32 0x32 0x32 0x32 0x32 0x32 0x32 0x32 0x32 0x32 0x32 0x32 0x32 0x32 0x32 0x32 0x32 0x32 0x32 0x32 0x32 0x32 0x32 0x32 0x32 0x32 0x32 0x32 0x32 0x32 0x32 0x32 0x32 0x32 0x32 0x32 0x32 0x32 0x32 0x32 0x32 0x32 0x32 0x32 0x32 0x32 0x32 0x32 0x32 0x32 0x32 0x32 0x32 0x32 0x32 0x32 0x32 0x32 0x32 0x32 0x32 0x32 0x32 0x32 0x32 0x32 0x32 0x32 0x32 0x32 0x32 0x32 0x32 0x32 0x32 0x32 0x32 0x32 0x32 0x32 0x32 0x32 0x32 0x32 0x32 0x32 0x32 0x32 0x32 0x32 0x32 0x32 0x32 0x32 0x32 0x32 0x32 0x32 0x32 0x32 0x32 0x32 0x32 0x32 0x32 0x32 0x32 0x32 0x32 0x32 0x32 0x32 0x32 0x32 0x32 0x32 0x32 0x32 0x32 0x32 0x32 0x32 0x32 0x32 0x32 0x32 0x32 0x32 0x32 0x32 0x32 0x32 0x32 0x32 0x32 0x32 0x32 0x32 0x32 0x32 0x32 0x32 0x32 0x32 0x32 0x32 0x32 0x32 0x32 0x32 0x32 0x32 0x32 0x32 0x32 0x32 0x32 0x32 0x32 0x32 0x32 0x32 0x32 0x32 0x32 0x32 0x32 0x32 0x32 0x32 0x32 0x32 0x32 0x32 0x32 0x32 0x32 0x32 0x32 0x32 0x32 0x32 0x32 0x32 0x32 0x32 0x32 0x32 0x32 0x32 0x32 0x32 0x32 0x32 0x32 0x32 0x32 0x32 0x32 0x32 0x32 0x32 0x32 0x32 0x32 0x32 0x32 0x32 0x32 0x32 0x32 0x32 0x32 0x32 0x32 0x32 0x32 0x32 0x32 0x32 0x32 0x32 0x32 0x32 0x32 0x32 0x32 0x32 0x32 0x32 0x32 0x32 0x32 0x32 0x32 0x32 0x32 0x32 0x32 0x32 0x32 0x32 0x32 0x32 0x32 0x32 0x32 0x32 0x32 0x32 0x32 0x32 0x32 0x32 0x32 0x32 0x32 0x32 0x32 0x32 0x32 0x32 0x32 0x32 0x32 0x32 0x32 0x32 0x32 0x32 0x32 0x32 0x32 0x32 0x32 0x32 0x32 0x32 0x32 0x32 0x32 0x32 0x32 0x32 0x32 0x32 0x32 0x32 0x32 0x32 0x32 0x32 0x32 0x32 0x32 0x32 0x32 0x32 0x32 0x32 0x32 0x32 0x32 0x32 0x32 0x32 0x32 0x32 0x32 0x32 0x32 0x32 0x32 0x32 0x32 0x32 0x32 0x32 0x32 0x32 0x32 0x32 0x32 0x32 0x32 0x32 0x32 0x32 0x32 0x32 0x32 0x32 0x32 0x32 0x32 0x32 0x32 0x32 0x32 0x32 0x32 0x32 0x32 0x4b 0x4b 0x4b>;
					PS_Config_Lmt_FW_Diff_N = <0xffffffce 0xffffffce 0xffffffce 0xffffffce 0xffffffce 0xffffffce 0xffffffce 0xffffffce 0xffffffce 0xffffffce 0xffffffce 0xffffffce 0xffffffce 0xffffffce 0xffffffce 0xffffffce 0xffffffce 0xffffffce 0xffffffce 0xffffffce 0xffffffce 0xffffffce 0xffffffce 0xffffffce 0xffffffce 0xffffffce 0xffffffce 0xffffffce 0xffffffce 0xffffffce 0xffffffce 0xffffffce 0xffffffce 0xffffffce 0xffffffce 0xffffffce 0xffffffce 0xffffffce 0xffffffce 0xffffffce 0xffffffce 0xffffffce 0xffffffce 0xffffffce 0xffffffce 0xffffffce 0xffffffce 0xffffffce 0xffffffce 0xffffffce 0xffffffce 0xffffffce 0xffffffce 0xffffffce 0xffffffce 0xffffffce 0xffffffce 0xffffffce 0xffffffce 0xffffffce 0xffffffce 0xffffffce 0xffffffce 0xffffffce 0xffffffce 0xffffffce 0xffffffce 0xffffffce 0xffffffce 0xffffffce 0xffffffce 0xffffffce 0xffffffce 0xffffffce 0xffffffce 0xffffffce 0xffffffce 0xffffffce 0xffffffce 0xffffffce 0xffffffce 0xffffffce 0xffffffce 0xffffffce 0xffffffce 0xffffffce 0xffffffce 0xffffffce 0xffffffce 0xffffffce 0xffffffce 0xffffffce 0xffffffce 0xffffffce 0xffffffce 0xffffffce 0xffffffce 0xffffffce 0xffffffce 0xffffffce 0xffffffce 0xffffffce 0xffffffce 0xffffffce 0xffffffce 0xffffffce 0xffffffce 0xffffffce 0xffffffce 0xffffffce 0xffffffce 0xffffffce 0xffffffce 0xffffffce 0xffffffce 0xffffffce 0xffffffce 0xffffffce 0xffffffce 0xffffffce 0xffffffce 0xffffffce 0xffffffce 0xffffffce 0xffffffce 0xffffffce 0xffffffce 0xffffffce 0xffffffce 0xffffffce 0xffffffce 0xffffffce 0xffffffce 0xffffffce 0xffffffce 0xffffffce 0xffffffce 0xffffffce 0xffffffce 0xffffffce 0xffffffce 0xffffffce 0xffffffce 0xffffffce 0xffffffce 0xffffffce 0xffffffce 0xffffffce 0xffffffce 0xffffffce 0xffffffce 0xffffffce 0xffffffce 0xffffffce 0xffffffce 0xffffffce 0xffffffce 0xffffffce 0xffffffce 0xffffffce 0xffffffce 0xffffffce 0xffffffce 0xffffffce 0xffffffce 0xffffffce 0xffffffce 0xffffffce 0xffffffce 0xffffffce 0xffffffce 0xffffffce 0xffffffce 0xffffffce 0xffffffce 0xffffffce 0xffffffce 0xffffffce 0xffffffce 0xffffffce 0xffffffce 0xffffffce 0xffffffce 0xffffffce 0xffffffce 0xffffffce 0xffffffce 0xffffffce 0xffffffce 0xffffffce 0xffffffce 0xffffffce 0xffffffce 0xffffffce 0xffffffce 0xffffffce 0xffffffce 0xffffffce 0xffffffce 0xffffffce 0xffffffce 0xffffffce 0xffffffce 0xffffffce 0xffffffce 0xffffffce 0xffffffce 0xffffffce 0xffffffce 0xffffffce 0xffffffce 0xffffffce 0xffffffce 0xffffffce 0xffffffce 0xffffffce 0xffffffce 0xffffffce 0xffffffce 0xffffffce 0xffffffce 0xffffffce 0xffffffce 0xffffffce 0xffffffce 0xffffffce 0xffffffce 0xffffffce 0xffffffce 0xffffffce 0xffffffce 0xffffffce 0xffffffce 0xffffffce 0xffffffce 0xffffffce 0xffffffce 0xffffffce 0xffffffce 0xffffffce 0xffffffce 0xffffffce 0xffffffce 0xffffffce 0xffffffce 0xffffffce 0xffffffce 0xffffffce 0xffffffce 0xffffffce 0xffffffce 0xffffffce 0xffffffce 0xffffffce 0xffffffce 0xffffffce 0xffffffce 0xffffffce 0xffffffce 0xffffffce 0xffffffce 0xffffffce 0xffffffce 0xffffffce 0xffffffce 0xffffffce 0xffffffce 0xffffffce 0xffffffce 0xffffffce 0xffffffce 0xffffffce 0xffffffce 0xffffffce 0xffffffce 0xffffffce 0xffffffce 0xffffffce 0xffffffce 0xffffffce 0xffffffce 0xffffffce 0xffffffce 0xffffffce 0xffffffce 0xffffffce 0xffffffce 0xffffffce 0xffffffce 0xffffffce 0xffffffce 0xffffffce 0xffffffce 0xffffffce 0xffffffce 0xffffffce 0xffffffce 0xffffffce 0xffffffce 0xffffffce 0xffffffce 0xffffffce 0xffffffce 0xffffffce 0xffffffce 0xffffffce 0xffffffce 0xffffffce 0xffffffce 0xffffffce 0xffffffce 0xffffffce 0xffffffce 0xffffffce 0xffffffce 0xffffffce 0xffffffce 0xffffffce 0xffffffce 0xffffffce 0xffffffce 0xffffffce 0xffffffce 0xffffffce 0xffffffce 0xffffffce 0xffffffce 0xffffffce 0xffffffce 0xffffffce 0xffffffce 0xffffffce 0xffffffce 0xffffffce 0xffffffce 0xffffffce 0xffffffce 0xffffffce 0xffffffce 0xffffffce 0xffffffce 0xffffffce 0xffffffce 0xffffffce 0xffffffce 0xffffffce 0xffffffce 0xffffffce 0xffffffce 0xffffffce 0xffffffce 0xffffffce 0xffffffce 0xffffffce 0xffffffce 0xffffffce 0xffffffce 0xffffffce 0xffffffce 0xffffffce 0xffffffce 0xffffffce 0xffffffce 0xffffffce 0xffffffce 0xffffffce 0xffffffce 0xffffffce 0xffffffce 0xffffffce 0xffffffce 0xffffffce 0xffffffce 0xffffffce 0xffffffce 0xffffffce 0xffffffce 0xffffffce 0xffffffce 0xffffffce 0xffffffce 0xffffffce 0xffffffce 0xffffffce 0xffffffce 0xffffffce 0xffffffce 0xffffffce 0xffffffce 0xffffffce 0xffffffce 0xffffffce 0xffffffce 0xffffffce 0xffffffce 0xffffffce 0xffffffce 0xffffffce 0xffffffce 0xffffffce 0xffffffce 0xffffffce 0xffffffce 0xffffffce 0xffffffce 0xffffffce 0xffffffce 0xffffffce 0xffffffce 0xffffffce 0xffffffce 0xffffffce 0xffffffce 0xffffffce 0xffffffce 0xffffffce 0xffffffce 0xffffffce 0xffffffce 0xffffffce 0xffffffce 0xffffffce 0xffffffce 0xffffffce 0xffffffce 0xffffffce 0xffffffce 0xffffffce 0xffffffce 0xffffffce 0xffffffce 0xffffffce 0xffffffce 0xffffffce 0xffffffce 0xffffffce 0xffffffce 0xffffffce 0xffffffce 0xffffffce 0xffffffce 0xffffffce 0xffffffce 0xffffffce 0xffffffce 0xffffffce 0xffffffce 0xffffffce 0xffffffce 0xffffffce 0xffffffce 0xffffffce 0xffffffce 0xffffffce 0xffffffce 0xffffffce 0xffffffce 0xffffffce 0xffffffce 0xffffffce 0xffffffce 0xffffffce 0xffffffce 0xffffffce 0xffffffce 0xffffffce 0xffffffce 0xffffffce 0xffffffce 0xffffffce 0xffffffce 0xffffffce 0xffffffce 0xffffffce 0xffffffce 0xffffffce 0xffffffce 0xffffffce 0xffffffce 0xffffffce 0xffffffce 0xffffffce 0xffffffce 0xffffffce 0xffffffce 0xffffffce 0xffffffce 0xffffffce 0xffffffce 0xffffffce 0xffffffce 0xffffffce 0xffffffce 0xffffffce 0xffffffce 0xffffffce 0xffffffce 0xffffffce 0xffffffce 0xffffffce 0xffffffce 0xffffffce 0xffffffce 0xffffffce 0xffffffce 0xffffffce 0xffffffce 0xffffffce 0xffffffce 0xffffffce 0xffffffce 0xffffffce 0xffffffce 0xffffffce 0xffffffce 0xffffffce 0xffffffce 0xffffffce 0xffffffce 0xffffffce 0xffffffce 0xffffffce 0xffffffce 0xffffffce 0xffffffce 0xffffffce 0xffffffce 0xffffffce 0xffffffce 0xffffffce 0xffffffce 0xffffffce 0xffffffce 0xffffffce 0xffffffce 0xffffffce 0xffffffce 0xffffffce 0xffffffce 0xffffffce 0xffffffce 0xffffffce 0xffffffce 0xffffffce 0xffffffce 0xffffffce 0xffffffce 0xffffffce 0xffffffce 0xffffffce 0xffffffce 0xffffffce 0xffffffce 0xffffffce 0xffffffce 0xffffffce 0xffffffce 0xffffffce 0xffffffce 0xffffffce 0xffffffce 0xffffffce 0xffffffce 0xffffffce 0xffffffce 0xffffffce 0xffffffce 0xffffffce 0xffffffce 0xffffffce 0xffffffce 0xffffffce 0xffffffce 0xffffffce 0xffffffce 0xffffffce 0xffffffce 0xffffffce 0xffffffce 0xffffffce 0xffffffce 0xffffffce 0xffffffce 0xffffffce 0xffffffce 0xffffffce 0xffffffce 0xffffffce 0xffffffce 0xffffffce 0xffffffce 0xffffffce 0xffffffce 0xffffffce 0xffffffce 0xffffffce 0xffffffce 0xffffffce 0xffffffce 0xffffffce 0xffffffce 0xffffffce 0xffffffce 0xffffffce 0xffffffce 0xffffffce 0xffffffce 0xffffffce 0xffffffce 0xffffffce 0xffffffce 0xffffffce 0xffffffce 0xffffffce 0xffffffce 0xffffffce 0xffffffce 0xffffffce 0xffffffce 0xffffffce 0xffffffce 0xffffffce 0xffffffce 0xffffffce 0xffffffce 0xffffffce 0xffffffce 0xffffffce 0xffffffce 0xffffffce 0xffffffce 0xffffffce 0xffffffce 0xffffffce 0xffffffce 0xffffffce 0xffffffce 0xffffffce 0xffffffce 0xffffffce 0xffffffce 0xffffffce 0xffffffce 0xffffffce 0xffffffce 0xffffffce 0xffffffce 0xffffffce 0xffffffb5 0xffffffb5 0xffffffb5>;
					PS_Config_Diff_Test_Frame = <0x32>;
				};
			};
		};
	};

	fragment@8 {
		target = <0xffffffff>;

		__overlay__ {

			awinic_haptic@58 {
				compatible = "awinic,awinic_haptic";
				reg = <0x58>;
				aw8622x_i2c_addr = <0x58>;
				reset-gpio = <0xffffffff 0x35 0x00>;
				irq-gpio = <0xffffffff 0x34 0x00>;
				aw8624_vib_mode = <0x00>;
				aw8624_vib_f0_pre = <0x92e>;
				aw8624_vib_f0_cali_percen = <0x07>;
				aw8624_vib_cont_drv_lev = <0x7d>;
				aw8624_vib_cont_drv_lvl_ov = <0x9b>;
				aw8624_vib_cont_td = <0xf06c>;
				aw8624_vib_cont_zc_thr = <0x8f8>;
				aw8624_vib_cont_num_brk = <0x03>;
				aw8624_vib_f0_coeff = <0x104>;
				aw8624_vib_brake_cont_config = <0x01 0x01 0x5a 0x2a 0x14 0x05 0x02 0x02 0x00 0x00 0x00 0x00 0x00 0x00 0x00 0x00 0x00 0x00 0x00 0x00 0x00 0x00 0x00 0x00>;
				aw8624_vib_f0_trace_parameter = <0x05 0x03 0x02 0x0f>;
				aw8624_vib_bemf_config = <0x10 0x08 0x23 0xf8>;
				aw8624_vib_sw_brake = <0x2c 0x08>;
				aw8624_vib_trig_config = <0x01 0x01 0x00 0x01 0x01>;
				aw8624_vib_tset = <0x11>;
				aw8624_vib_duration_time = <0x14 0x1e 0x3c>;
				aw8622x_vib_mode = <0x00>;
				aw8622x_vib_f0_pre = <0x92e>;
				aw8622x_vib_f0_cali_percen = <0x07>;
				aw8622x_vib_cont_drv1_lvl = <0x7f>;
				aw8622x_vib_cont_drv2_lvl = <0x36>;
				aw8622x_vib_cont_brk_time = <0x08>;
				aw8622x_vib_cont_tset = <0x06>;
				aw8622x_vib_cont_bemf_set = <0x02>;
				aw8622x_vib_cont_drv_width = <0x47>;
				aw8622x_vib_cont_wait_num = <0x06>;
				aw8622x_vib_cont_brk_gain = <0x08>;
				aw8622x_vib_cont_drv1_time = <0x04>;
				aw8622x_vib_cont_drv2_time = <0x14>;
				aw8622x_vib_cont_track_margin = <0x12>;
				aw8622x_vib_sine_array = <0x05 0xb2 0xff 0xef>;
				aw8622x_vib_d2s_gain = <0x07>;
				aw8622x_vib_prctmode = <0x2d 0x3e 0x3f>;
				aw8622x_vib_trig_config = <0x01 0x00 0x01 0x01 0x01 0x02 0x00 0x01 0x00 0x00 0x01 0x00 0x02 0x00 0x01 0x00 0x00 0x01 0x00 0x02 0x00>;
				aw8622x_vib_duration_time = <0x1e 0x3c 0x5a>;
				aw8622x_vib_is_enabled_auto_bst;
				status = "okay";
			};
		};
	};

	fragment@9 {
		target = <0xffffffff>;

		__overlay__ {

			gps_default {
				phandle = <0x19>;
			};

			gps_l1_lna@0 {
				phandle = <0x1a>;

				pins_cmd_dat {
					pinmux = <0xac00>;
					output-low;
				};
			};

			gps_l1_lna@1 {
				phandle = <0x1b>;

				pins_cmd_dat {
					pinmux = <0xac02>;
				};
			};

			gps_l1_lna@2 {
				phandle = <0x1c>;

				pins_cmd_dat {
					pinmux = <0xac00>;
					output-high;
				};
			};

			gps_l5_lna@0 {
				phandle = <0x1d>;

				pins_cmd_dat {
					pinmux = <0xad00>;
					output-low;
				};
			};

			gps_l5_lna@1 {
				phandle = <0x1e>;

				pins_cmd_dat {
					pinmux = <0xad02>;
				};
			};

			gps_l5_lna@2 {
				phandle = <0x1f>;

				pins_cmd_dat {
					pinmux = <0xad00>;
					output-high;
				};
			};
		};
	};

	fragment@10 {
		target = <0xffffffff>;

		__overlay__ {
			cam2_enable_sensor = "gc02m1b_mipi_raw";
			cam3_enable_sensor = "gc02m1_mipi_raw";
		};
	};

	fragment@11 {
		target = <0xffffffff>;

		__overlay__ {
			pinctrl-names = "default\0gps_l1_lna_disable\0gps_l1_lna_dsp_ctrl\0gps_l1_lna_enable\0gps_l5_lna_disable\0gps_l5_lna_dsp_ctrl\0gps_l5_lna_enable";
			pinctrl-0 = <0x19>;
			pinctrl-1 = <0x1a>;
			pinctrl-2 = <0x1b>;
			pinctrl-3 = <0x1c>;
			pinctrl-4 = <0x1d>;
			pinctrl-5 = <0x1e>;
			pinctrl-6 = <0x1f>;
			status = "okay";
		};
	};

	fragment@12 {
		target = <0xffffffff>;

		__overlay__ {
			clock-frequency = <0x61a80>;

			mtk-usb@60 {
				compatible = "mediatek,mtk-usb";
				reg = <0x60>;
				status = "okay";
			};
		};
	};

	fragment@13 {
		target = <0xffffffff>;

		__overlay__ {

			dualdefault1 {
				phandle = <0x27>;
			};

			dv2_high1 {
				phandle = <0x28>;

				pins_cmd_dat {
					pinmux = <0xad00>;
					slew-rate = <0x01>;
					output-high;
				};
			};

			dv2_low1 {
				phandle = <0x29>;

				pins_cmd_dat {
					pinmux = <0xad00>;
					slew-rate = <0x01>;
					output-low;
				};
			};

			dualdefault2 {
				phandle = <0x2c>;
			};

			dv2_high2 {
				phandle = <0x2d>;

				pins_cmd_dat {
					pinmux = <0xab00>;
					slew-rate = <0x01>;
					output-high;
				};
			};

			dv2_low2 {
				phandle = <0x2e>;

				pins_cmd_dat {
					pinmux = <0xab00>;
					slew-rate = <0x01>;
					output-low;
				};
			};

			dv2_i2c_sda8 {
				phandle = <0x2a>;

				pins_cmd_dat {
					pinmux = <0x9f01>;
				};
			};

			dv2_i2c_scl8 {
				phandle = <0x2b>;

				pins_cmd_dat {
					pinmux = <0x9e01>;
				};
			};
		};
	};

	fragment@14 {
		target = <0xffffffff>;

		__overlay__ {
			accdet-mic-vol = <0x06>;
			headset-mode-setting = <0x500 0x500 0x01 0x1f0 0x800 0x800 0x20 0x44>;
			accdet-plugout-debounce = <0x01>;
			accdet-mic-mode = <0x01>;
			headset-eint-level-pol = <0x08>;
			headset-three-key-threshold = <0x00 0x50 0xdc 0x190>;
			headset-three-key-threshold-CDD = <0x00 0x79 0xc0 0x258>;
			headset-four-key-threshold = <0x00 0x3a 0x79 0xc0 0x190>;
			status = "okay";
		};
	};

	fragment@15 {
		target = <0xffffffff>;

		__overlay__ {

			lcm_rst_out1_gpio {
				phandle = <0x20>;

				pins_cmd_dat {
					pinmux = <0x6300>;
					slew-rate = <0x01>;
					output-high;
				};
			};

			lcm_rst_out0_gpio {
				phandle = <0x21>;

				pins_cmd_dat {
					pinmux = <0x6300>;
					slew-rate = <0x01>;
					output-low;
				};
			};

			lcm_dsi_te {
				phandle = <0x22>;

				pins_cmd_dat {
					pinmux = <0x6101>;
				};
			};
		};
	};

	fragment@16 {
		target = <0xffffffff>;

		__overlay__ {
			pinctrl-names = "lcm_rst_out1_gpio\0lcm_rst_out0_gpio\0mode_te_te";
			pinctrl-0 = <0x20>;
			pinctrl-1 = <0x21>;
			pinctrl-2 = <0x22>;
			status = "okay";
		};
	};

	fragment@17 {
		target = <0xffffffff>;

		__overlay__ {
			pinctrl-names = "lcm_rst_out1_gpio\0lcm_rst_out0_gpio\0mode_te_te";
			pinctrl-0 = <0x20>;
			pinctrl-1 = <0x21>;
			pinctrl-2 = <0x22>;
			status = "okay";
		};
	};

	fragment@18 {
		target = <0xffffffff>;

		__overlay__ {
			status = "okay";
			#address-cells = <0x01>;
			#size-cells = <0x00>;

			panel1@0 {
				compatible = "nt36672c,fhdp,dsi,vdo,txd,boe,120hz,x697";
				reg = <0x00>;
				reset-gpios = <0xffffffff 0x63 0x00>;
				bias-gpios = <0xffffffff 0xa7 0x00 0xffffffff 0xa9 0x00>;
				pinctrl-names = "default";

				port {

					endpoint {
						remote-endpoint = <0x23>;
						phandle = <0x24>;
					};
				};
			};

			ports {

				port {

					endpoint {
						remote-endpoint = <0x24>;
						phandle = <0x23>;
					};
				};
			};
		};
	};

	fragment@19 {
		target = <0xffffffff>;

		__overlay__ {
			pinctrl-names = "irtx_gpio_led_default\0irtx_gpio_led_set";
			pinctrl-0 = <0x25>;
			pinctrl-1 = <0x26>;
			status = "okay";
		};
	};

	fragment@20 {
		target = <0xffffffff>;

		__overlay__ {

			irtx_gpio_led_def@gpio42 {
				phandle = <0x25>;

				pins_cmd_dat {
					pinmux = <0x2a00>;
					slew-rate = <0x01>;
					bias-disable;
					output-low;
					input-schmitt-enable = <0x00>;
				};
			};

			irtx_gpio_led_set@gpio42 {
				phandle = <0x26>;

				pins_cmd_dat {
					pinmux = <0x2a03>;
					slew-rate = <0x01>;
					output-high;
				};
			};
		};
	};

	fragment@21 {
		target = <0xffffffff>;

		__overlay__ {

			otg_iddig {
				compatible = "mediatek,usb_iddig_bi_eint";
				interrupt-parent = <0xffffffff>;
				interrupts = <0x53 0x08>;
				fake_typec_otg_detect;
				io-channels = <0xffffffff 0x05>;
				io-channel-names = "AUX_CHG";
				status = "okay";
				phandle = <0x66>;
			};

			tran_battery {
				compatible = "tran,chg_fun";
				enable_pcb_tml;
				pcb_temp_step_one = <0x9c40>;
				pcb_cur_step_one = <0x1f4>;
				pcb_temp_step_two = <0xabe0>;
				pcb_cur_step_two = <0x1f4>;
				pcb_min_chg_cur = <0xf4240>;
				jeita_below_t0_chg_cur = <0x00>;
				jeita_t0_to_t1_chg_cur = <0xf4240>;
				jeita_t2_to_t3_chg_cur = <0x1e8480>;
				jeita_t3_to_t4_chg_cur = <0x1e8480>;
				jeita_above_t4_chg_cur = <0x00>;
				jeita_below_t0_input_cur = <0x16e360>;
				jeita_t0_to_t1_input_cur = <0x16e360>;
				jeita_t2_to_t3_input_cur = <0x200b20>;
				jeita_t3_to_t4_input_cur = <0x200b20>;
				jeita_above_t4_input_cur = <0xf4240>;
				phandle = <0x67>;
			};

			tran_battery_aging {
				compatible = "tran,chg_aging";
				battery_aging_module0 = <0x00>;
				battery_aging_module1 = <0x00>;
				battery_aging_module2 = <0x00>;
				battery_aging_module3 = <0x00>;
				phandle = <0x68>;
			};

			usb_switch {
				compatible = "tran,usb_switch";
				rfc,sda8_gpio = <0xffffffff 0x9f 0x00>;
				rfc,scl8_gpio = <0xffffffff 0x9e 0x00>;
				pinctrl-names = "dv2_usb_switch_gpio_init1\0dv2_usb_switch_gpio_high1\0dv2_usb_switch_gpio_low1\0dv2_rfc_sda8\0dv2_rfc_scl8\0dv2_usb_switch_gpio_init2\0dv2_usb_switch_gpio_high2\0dv2_usb_switch_gpio_low2";
				pinctrl-0 = <0x27>;
				pinctrl-1 = <0x28>;
				pinctrl-2 = <0x29>;
				pinctrl-3 = <0x2a>;
				pinctrl-4 = <0x2b>;
				pinctrl-5 = <0x2c>;
				pinctrl-6 = <0x2d>;
				pinctrl-7 = <0x2e>;
				status = "okay";
				phandle = <0x69>;
			};

			pca_rfc_ta {
				compatible = "richtek,pca_rfc_ta";
				status = "okay";
				vta_step = <0x14>;
				ita_step = <0x1e>;
				ita_gap_per_vstep = <0x14>;
				pwr_lmt;
				support_meas_cap;
				support_status;
			};

			usb_phy_tuning {
				compatible = "mediatek,phy_tuning";
				u2_vrt_ref = <0x07>;
				u2_term_ref = <0x07>;
				u2_enhance = <0x02>;
				u2_vrt_otg = <0x06>;
				u2_term_otg = <0x06>;
				u2_enhance_otg = <0x02>;
			};
		};
	};

	fragment@22 {
		target = <0xffffffff>;

		__overlay__ {

			rfc_ta@1b {
				compatible = "richtek,rfc_ta";
				reg = <0x1b>;
				status = "okay";
			};
		};
	};

	fragment@23 {
		target = <0xffffffff>;

		__overlay__ {
			compatible = "mediatek,charger";
			algorithm_name = "SwitchCharging";
			enable_sw_jeita;
			enable_pe_plus;
			enable_pe_2;
			enable_hvdcp20;
			enable_tc30;
			enable_pe_5;
			power_path_support;
			enable_ir_comp;
			r_bat_comp = <0x1e>;
			v_comp_max = <0x9c40>;
			disable_pd_dual;
			multi_battery_cv;
			battery_cv = <0x43e6d0 0x43e6d0 0x43e6d0 0x43e6d0>;
			max_charger_voltage = <0x632ea0>;
			min_charger_voltage = <0x4630c0>;
			min_charger_voltage_1 = <0x432380>;
			min_charger_voltage_2 = <0x401640>;
			max_dmivr_charger_current = <0x155cc0>;
			usb_charger_current_suspend = <0x00>;
			usb_charger_current_unconfigured = <0x11170>;
			usb_charger_current_configured = <0x7a120>;
			usb_charger_current = <0x7a120>;
			ac_charger_current = <0x2191c0>;
			ac_charger_input_current = <0x1e8480>;
			non_std_ac_charger_current = <0x124f80>;
			charging_host_charger_current = <0x16e360>;
			apple_1_0a_charger_current = <0x9eb10>;
			apple_2_1a_charger_current = "\0\f5";
			ta_ac_charger_current = <0x2dc6c0>;
			jeita_temp_above_t4_cv = <0x3f52f0 0x3f52f0 0x3f52f0 0x3f52f0>;
			jeita_temp_t3_to_t4_cv = <0x3f52f0 0x3f52f0 0x3f52f0 0x3f52f0>;
			jeita_temp_t2_to_t3_cv = <0x43e6d0 0x43e6d0 0x43e6d0 0x43e6d0>;
			jeita_temp_t1_to_t2_cv = <0x43e6d0 0x43e6d0 0x43e6d0 0x43e6d0>;
			jeita_temp_t0_to_t1_cv = <0x43e6d0 0x43e6d0 0x43e6d0 0x43e6d0>;
			jeita_temp_below_t0_cv = <0x43e6d0 0x43e6d0 0x43e6d0 0x43e6d0>;
			temp_t4_thres = <0x37>;
			temp_t4_thres_minus_x_degree = <0x33>;
			temp_t3_thres = <0x2d>;
			temp_t3_thres_minus_x_degree = <0x2c>;
			temp_t2_thres = <0x0f>;
			temp_t2_thres_plus_x_degree = <0x10>;
			temp_t1_thres = <0x01>;
			temp_t1_thres_plus_x_degree = <0x01>;
			temp_t0_thres = <0x01>;
			temp_t0_thres_plus_x_degree = <0x01>;
			temp_neg_10_thres = <0x02>;
			enable_min_charge_temp;
			min_charge_temp = <0x00>;
			min_charge_temp_plus_x_degree = <0x01>;
			max_charge_temp = <0x35>;
			max_charge_temp_minus_x_degree = <0x34>;
			ta_9v_support;
			pe_ichg_level_threshold = <0xf4240>;
			ta_ac_12v_input_current = <0x30d400>;
			ta_ac_9v_input_current = <0x200b20>;
			ta_ac_7v_input_current = <0x1e8480>;
			pe20_ichg_level_threshold = <0xf4240>;
			ta_start_battery_soc = <0x00>;
			ta_stop_battery_soc = <0x5a>;
			high_temp_to_leave_pe40 = <0x2e>;
			high_temp_to_enter_pe40 = <0x27>;
			low_temp_to_leave_pe40 = <0x0a>;
			low_temp_to_enter_pe40 = <0x10>;
			pe40_single_charger_input_current = <0x2dc6c0>;
			pe40_single_charger_current = <0x2dc6c0>;
			pe40_dual_charger_input_current = <0x2dc6c0>;
			pe40_dual_charger_chg1_current = <0x1e8480>;
			pe40_dual_charger_chg2_current = <0x1e8480>;
			pe40_stop_battery_soc = <0x50>;
			pe40_r_cable_1a_lower = <0x206>;
			pe40_r_cable_2a_lower = <0x17f>;
			pe40_r_cable_3a_lower = <0xf5>;
			chg1_ta_ac_charger_current = <0x16e360>;
			chg2_ta_ac_charger_current = <0x16e360>;
			slave_mivr_diff = <0x186a0>;
			dual_polling_ieoc = <0x6ddd0>;
			cable_imp_threshold = <0x2bb>;
			vbat_cable_imp_threshold = <0x3b8260>;
			bif_threshold1 = <0x40d990>;
			bif_threshold2 = <0x419ce0>;
			bif_cv_under_threshold2 = <0x43e6d0>;
			pd_vbus_low_bound = <0x4c4b40>;
			pd_vbus_upper_bound = <0x4c4b40>;
			pd_ichg_level_threshold = <0xf4240>;
			pd_stop_battery_soc = <0x50>;
			ibus_err = <0x0e>;
			vsys_watt = <0x4c4b40>;
			max_charging_time = <0x11940>;
			dv2_chg_cv = "\0D\\\0\0D\\\0\0D\\\0\0D\\";
			dv2_chg_eoc = <0x9eb10>;
		};
	};

	fragment@24 {
		target = <0xffffffff>;

		__overlay__ {
			compatible = "mediatek,lk_charger";
			enable_anime;
			enable_pe_plus;
			enable_pd20_reset;
			power_path_support;
			max_charger_voltage = <0x632ea0>;
			fast_charge_voltage = <0x2625a0>;
			usb_charger_current = <0x7a120>;
			ac_charger_current = <0x16e360>;
			ac_charger_input_current = <0x16e360>;
			non_std_ac_charger_current = <0x7a120>;
			charging_host_charger_current = <0x16e360>;
			ta_ac_charger_current = <0x2dc6c0>;
			pd_charger_current = <0x7a120>;
			cur_threshold = <0x7a120>;
			temp_t4_threshold = <0x32>;
			temp_t3_threshold = <0x2d>;
			temp_t2_threshold = <0x0f>;
			temp_t1_threshold = <0x00>;
		};
	};

	fragment@25 {
		target = <0xffffffff>;

		__overlay__ {

			adc_channel@ {
				compatible = "mediatek,adc_channel";
				mediatek,adc_fdd_rf_params_dynamic_custom_ch = <0x02>;
				status = "okay";
			};
		};
	};

	fragment@26 {
		target = <0xffffffff>;

		__overlay__ {
			io-channels = <0xffffffff 0x02>;
		};
	};

	fragment@27 {
		target = <0xffffffff>;

		__overlay__ {
			mediatek,clkbuf-quantity = <0x07>;
			mediatek,clkbuf-config = <0x02 0x01 0x01 0x02 0x00 0x00 0x01>;
			mediatek,clkbuf-driving-current = <0x01 0x01 0x01 0x01 0x01 0x01 0x01>;
			status = "okay";
		};
	};

	fragment@28 {
		target = <0xffffffff>;

		__overlay__ {
			#address-cells = <0x01>;
			#size-cells = <0x00>;
			clock-frequency = <0x61a80>;
			mediatek,use-open-drain;
		};
	};

	fragment@29 {
		target = <0xffffffff>;

		__overlay__ {
			#address-cells = <0x01>;
			#size-cells = <0x00>;
			clock-frequency = <0x61a80>;
			mediatek,use-open-drain;
		};
	};

	fragment@30 {
		target = <0xffffffff>;

		__overlay__ {
			#address-cells = <0x01>;
			#size-cells = <0x00>;
			clock-frequency = <0x61a80>;
			mediatek,use-open-drain;

			camera_main@10 {
				compatible = "mediatek,camera_main";
				reg = <0x10>;
				status = "okay";
				phandle = <0x6a>;
			};

			camera_main_af@0c {
				compatible = "mediatek,camera_main_af";
				reg = <0x0c>;
				status = "okay";
				phandle = <0x6b>;
			};

			camera_sub@20 {
				compatible = "mediatek,camera_sub";
				reg = <0x20>;
				status = "okay";
				phandle = <0x6c>;
			};
		};
	};

	fragment@31 {
		target = <0xffffffff>;

		__overlay__ {
			#address-cells = <0x01>;
			#size-cells = <0x00>;
			clock-frequency = <0x61a80>;
			mediatek,use-open-drain;

			strobe_main@63 {
				compatible = "mediatek,strobe_main";
				reg = <0x63>;
				status = "okay";
				phandle = <0x6d>;
			};

			nfc@08 {
				compatible = "mediatek,nfc";
				reg = <0x08>;
				status = "okay";
				phandle = <0x6e>;
			};
		};
	};

	fragment@32 {
		target = <0xffffffff>;

		__overlay__ {
			#address-cells = <0x01>;
			#size-cells = <0x00>;
			clock-frequency = <0x61a80>;
			mediatek,use-open-drain;

			camera_sub_two@10 {
				compatible = "mediatek,camera_sub_two";
				reg = <0x10>;
				status = "okay";
				phandle = <0x6f>;
			};
		};
	};

	fragment@33 {
		target = <0xffffffff>;

		__overlay__ {
			#address-cells = <0x01>;
			#size-cells = <0x00>;
			clock-frequency = <0x61a80>;
			mediatek,use-open-drain;

			subpmic_pmu@34 {
				compatible = "mediatek,subpmic_pmu";
				reg = <0x34>;
				status = "okay";
				phandle = <0x70>;
			};

			usb_type_c@4e {
				compatible = "mediatek,usb_type_c";
				reg = <0x4e>;
				status = "okay";
				phandle = <0x71>;
			};
		};
	};

	fragment@34 {
		target = <0xffffffff>;

		__overlay__ {
			#address-cells = <0x01>;
			#size-cells = <0x00>;
			clock-frequency = <0x61a80>;
			mediatek,use-open-drain;

			i2c_lcd_bias@3e {
				compatible = "mediatek,i2c_lcd_bias";
				reg = <0x3e>;
				status = "okay";
				phandle = <0x72>;
			};
		};
	};

	fragment@35 {
		target = <0xffffffff>;

		__overlay__ {
			#address-cells = <0x01>;
			#size-cells = <0x00>;
			clock-frequency = <0x186a0>;
			mediatek,use-open-drain;
		};
	};

	fragment@36 {
		target = <0xffffffff>;

		__overlay__ {
			#address-cells = <0x01>;
			#size-cells = <0x00>;
			clock-frequency = <0x61a80>;
			mediatek,use-open-drain;

			camera_main_two@10 {
				compatible = "mediatek,camera_main_two";
				reg = <0x10>;
				status = "okay";
				phandle = <0x73>;
			};
		};
	};

	fragment@37 {
		target = <0xffffffff>;

		__overlay__ {
			#address-cells = <0x01>;
			#size-cells = <0x00>;
			clock-frequency = <0x61a80>;
			mediatek,use-open-drain;
		};
	};

	fragment@38 {
		target = <0xffffffff>;

		__overlay__ {
			GPIO_SIM1_HOT_PLUG = <0xffffffff 0x1b 0x00>;
			GPIO_SIM1_SCLK = <0xffffffff 0x5b 0x00>;
			GPIO_SIM1_SRST = <0xffffffff 0x5c 0x00>;
			GPIO_SIM1_SIO = <0xffffffff 0x5d 0x00>;
			GPIO_SIM2_SCLK = <0xffffffff 0x5e 0x00>;
			GPIO_SIM2_SRST = <0xffffffff 0x5f 0x00>;
			GPIO_SIM2_SIO = <0xffffffff 0x60 0x00>;
		};
	};

	fragment@39 {
		target = <0xffffffff>;

		__overlay__ {
			gpio_init_default = <0x00 0x00 0x00 0x00 0x01 0x00 0x00 0x01 0x00 0x00 0x00 0x01 0x00 0x00 0x02 0x00 0x00 0x00 0x01 0x01 0x00 0x03 0x00 0x00 0x00 0x01 0x00 0x00 0x04 0x00 0x00 0x00 0x01 0x01 0x00 0x05 0x00 0x00 0x00 0x01 0x00 0x00 0x06 0x00 0x00 0x00 0x01 0x01 0x00 0x07 0x00 0x01 0x00 0x01 0x00 0x00 0x08 0x00 0x00 0x00 0x01 0x01 0x00 0x09 0x00 0x00 0x00 0x01 0x01 0x00 0x0a 0x00 0x00 0x00 0x01 0x00 0x00 0x0b 0x00 0x00 0x00 0x01 0x01 0x00 0x0c 0x00 0x00 0x00 0x01 0x00 0x00 0x0d 0x00 0x00 0x00 0x01 0x00 0x00 0x0e 0x02 0x00 0x00 0x01 0x00 0x00 0x0f 0x00 0x00 0x00 0x01 0x01 0x00 0x10 0x00 0x01 0x00 0x01 0x00 0x00 0x11 0x00 0x00 0x00 0x01 0x00 0x00 0x12 0x00 0x01 0x00 0x01 0x00 0x00 0x13 0x00 0x01 0x00 0x01 0x00 0x00 0x14 0x00 0x01 0x00 0x01 0x00 0x00 0x15 0x00 0x01 0x01 0x01 0x00 0x00 0x16 0x00 0x01 0x00 0x01 0x00 0x00 0x17 0x00 0x01 0x00 0x01 0x00 0x00 0x18 0x00 0x01 0x00 0x01 0x00 0x00 0x19 0x00 0x01 0x00 0x01 0x00 0x00 0x1a 0x00 0x01 0x00 0x01 0x00 0x00 0x1b 0x01 0x00 0x00 0x01 0x01 0x00 0x1c 0x00 0x00 0x00 0x01 0x00 0x00 0x1d 0x00 0x00 0x00 0x01 0x00 0x00 0x1e 0x00 0x00 0x00 0x01 0x00 0x00 0x1f 0x00 0x00 0x00 0x01 0x00 0x00 0x20 0x01 0x00 0x00 0x01 0x01 0x00 0x21 0x01 0x00 0x00 0x00 0x00 0x00 0x22 0x01 0x00 0x00 0x01 0x01 0x01 0x23 0x01 0x00 0x00 0x00 0x00 0x01 0x24 0x01 0x00 0x00 0x00 0x00 0x00 0x25 0x01 0x00 0x00 0x00 0x00 0x00 0x26 0x01 0x00 0x00 0x00 0x00 0x00 0x27 0x01 0x00 0x00 0x01 0x00 0x00 0x28 0x00 0x00 0x00 0x01 0x00 0x00 0x29 0x00 0x00 0x00 0x01 0x00 0x00 0x2a 0x00 0x00 0x00 0x01 0x00 0x00 0x2b 0x00 0x00 0x00 0x01 0x00 0x00 0x2c 0x02 0x00 0x00 0x00 0x00 0x00 0x2d 0x02 0x00 0x00 0x00 0x00 0x01 0x2e 0x02 0x00 0x00 0x00 0x00 0x00 0x2f 0x02 0x00 0x00 0x01 0x00 0x01 0x30 0x01 0x00 0x00 0x01 0x00 0x00 0x31 0x01 0x00 0x00 0x01 0x00 0x00 0x32 0x01 0x00 0x00 0x01 0x00 0x00 0x33 0x01 0x00 0x00 0x00 0x00 0x00 0x34 0x06 0x00 0x00 0x01 0x00 0x00 0x35 0x00 0x01 0x01 0x01 0x00 0x00 0x36 0x00 0x01 0x00 0x01 0x00 0x00 0x37 0x00 0x00 0x00 0x01 0x00 0x00 0x38 0x00 0x00 0x00 0x01 0x00 0x01 0x39 0x00 0x00 0x00 0x01 0x00 0x01 0x3a 0x00 0x00 0x00 0x01 0x00 0x01 0x3b 0x00 0x00 0x00 0x01 0x00 0x01 0x3c 0x03 0x00 0x00 0x00 0x00 0x00 0x3d 0x00 0x01 0x00 0x01 0x00 0x00 0x3e 0x06 0x00 0x00 0x01 0x01 0x00 0x3f 0x06 0x00 0x00 0x01 0x00 0x00 0x40 0x00 0x01 0x01 0x00 0x00 0x00 0x41 0x06 0x00 0x00 0x01 0x00 0x00 0x42 0x00 0x01 0x00 0x00 0x00 0x00 0x43 0x00 0x01 0x01 0x01 0x00 0x00 0x50 0x01 0x00 0x00 0x01 0x01 0x01 0x51 0x01 0x00 0x00 0x01 0x01 0x01 0x52 0x00 0x00 0x00 0x01 0x00 0x01 0x53 0x00 0x00 0x00 0x01 0x01 0x01 0x55 0x01 0x00 0x00 0x01 0x00 0x01 0x56 0x01 0x00 0x00 0x01 0x00 0x01 0x57 0x01 0x00 0x00 0x01 0x00 0x01 0x58 0x01 0x00 0x00 0x01 0x00 0x01 0x59 0x01 0x00 0x00 0x01 0x00 0x01 0x5a 0x01 0x00 0x00 0x01 0x00 0x01 0x5b 0x01 0x00 0x00 0x00 0x00 0x01 0x5c 0x01 0x00 0x00 0x00 0x00 0x01 0x5d 0x01 0x00 0x00 0x01 0x01 0x01 0x5e 0x01 0x00 0x00 0x00 0x00 0x01 0x5f 0x01 0x00 0x00 0x00 0x00 0x01 0x60 0x01 0x00 0x00 0x01 0x01 0x01 0x61 0x01 0x00 0x00 0x01 0x00 0x00 0x62 0x01 0x00 0x00 0x00 0x00 0x01 0x63 0x00 0x01 0x00 0x01 0x00 0x00 0x64 0x01 0x00 0x00 0x01 0x00 0x00 0x65 0x01 0x00 0x00 0x01 0x00 0x00 0x66 0x01 0x00 0x00 0x01 0x00 0x00 0x67 0x00 0x00 0x00 0x01 0x00 0x00 0x68 0x01 0x00 0x00 0x01 0x00 0x00 0x69 0x01 0x00 0x00 0x01 0x00 0x00 0x6a 0x01 0x00 0x00 0x01 0x00 0x00 0x6b 0x01 0x00 0x00 0x01 0x00 0x00 0x6c 0x00 0x00 0x00 0x01 0x00 0x00 0x6d 0x00 0x00 0x00 0x01 0x00 0x00 0x6e 0x01 0x00 0x00 0x01 0x00 0x00 0x6f 0x01 0x00 0x00 0x01 0x00 0x00 0x70 0x01 0x00 0x00 0x01 0x00 0x00 0x71 0x00 0x00 0x00 0x01 0x00 0x00 0x72 0x00 0x00 0x00 0x01 0x00 0x00 0x73 0x00 0x00 0x00 0x01 0x00 0x00 0x74 0x00 0x00 0x00 0x01 0x00 0x00 0x75 0x01 0x00 0x00 0x01 0x00 0x00 0x76 0x00 0x00 0x00 0x01 0x00 0x00 0x77 0x00 0x00 0x00 0x01 0x00 0x00 0x78 0x00 0x00 0x00 0x01 0x00 0x00 0x79 0x00 0x00 0x00 0x01 0x00 0x00 0x7a 0x00 0x00 0x00 0x01 0x00 0x00 0x7b 0x00 0x00 0x00 0x01 0x00 0x00 0x7c 0x00 0x00 0x00 0x01 0x00 0x00 0x7d 0x00 0x00 0x00 0x01 0x00 0x00 0x7e 0x01 0x00 0x00 0x01 0x00 0x00 0x7f 0x01 0x00 0x00 0x01 0x00 0x00 0x80 0x00 0x00 0x00 0x01 0x00 0x00 0x81 0x00 0x00 0x00 0x01 0x00 0x00 0x82 0x00 0x00 0x00 0x01 0x00 0x00 0x83 0x00 0x00 0x00 0x01 0x00 0x00 0x84 0x00 0x00 0x00 0x01 0x00 0x00 0x85 0x00 0x00 0x00 0x01 0x00 0x00 0x86 0x00 0x00 0x00 0x01 0x00 0x00 0x87 0x00 0x00 0x00 0x01 0x00 0x00 0x88 0x01 0x00 0x00 0x01 0x00 0x00 0x89 0x01 0x00 0x00 0x01 0x00 0x00 0x8a 0x01 0x00 0x00 0x01 0x00 0x00 0x8b 0x01 0x00 0x00 0x01 0x00 0x00 0x8c 0x01 0x00 0x00 0x00 0x00 0x00 0x8d 0x01 0x00 0x00 0x00 0x00 0x00 0x8e 0x01 0x00 0x00 0x00 0x00 0x00 0x8f 0x01 0x00 0x00 0x01 0x00 0x00 0x90 0x00 0x00 0x00 0x01 0x00 0x01 0x91 0x00 0x00 0x00 0x01 0x00 0x01 0x92 0x02 0x00 0x00 0x01 0x01 0x01 0x93 0x02 0x00 0x00 0x01 0x01 0x01 0x94 0x01 0x00 0x00 0x01 0x01 0x01 0x95 0x01 0x00 0x00 0x01 0x01 0x01 0x96 0x01 0x00 0x00 0x01 0x01 0x01 0x97 0x01 0x00 0x00 0x01 0x01 0x01 0x98 0x01 0x00 0x00 0x01 0x01 0x01 0x99 0x01 0x00 0x00 0x01 0x01 0x01 0x9a 0x01 0x00 0x00 0x01 0x01 0x01 0x9b 0x01 0x00 0x00 0x01 0x01 0x01 0x9c 0x01 0x00 0x00 0x01 0x01 0x01 0x9d 0x01 0x00 0x00 0x01 0x01 0x01 0x9e 0x01 0x00 0x00 0x01 0x01 0x01 0x9f 0x01 0x00 0x00 0x01 0x01 0x01 0xa0 0x01 0x00 0x00 0x01 0x01 0x01 0xa1 0x01 0x00 0x00 0x01 0x01 0x01 0xa2 0x01 0x00 0x00 0x01 0x01 0x01 0xa3 0x01 0x00 0x00 0x01 0x01 0x01 0xa4 0x00 0x01 0x00 0x01 0x00 0x00 0xa5 0x00 0x01 0x00 0x01 0x00 0x00 0xa6 0x00 0x01 0x00 0x01 0x00 0x00 0xa7 0x00 0x01 0x00 0x01 0x00 0x00 0xa8 0x00 0x01 0x00 0x00 0x00 0x01 0xa9 0x00 0x01 0x00 0x01 0x00 0x00 0xaa 0x00 0x01 0x00 0x01 0x00 0x00 0xab 0x00 0x01 0x00 0x01 0x00 0x00 0xac 0x02 0x00 0x00 0x01 0x00 0x00 0xad 0x00 0x01 0x00 0x01 0x00 0x00 0xae 0x01 0x00 0x00 0x00 0x00 0x01 0xaf 0x01 0x00 0x00 0x00 0x00 0x01 0xb0 0x01 0x00 0x00 0x01 0x00 0x01 0xb1 0x01 0x00 0x00 0x01 0x00 0x01 0xb2 0x01 0x00 0x00 0x00 0x00 0x00 0xb3 0x01 0x00 0x00 0x00 0x00 0x00 0xb4 0x01 0x00 0x00 0x00 0x00 0x01 0xb5 0x01 0x00 0x00 0x01 0x00 0x01 0xb6 0x01 0x00 0x00 0x00 0x00 0x00 0xb7 0x01 0x00 0x00 0x00 0x00 0x01 0xb8 0x01 0x00 0x00 0x00 0x00 0x01 0xb9 0x01 0x00 0x00 0x00 0x00 0x01 0xba 0x01 0x00 0x00 0x00 0x00 0x01 0xbb 0x01 0x00 0x00 0x01 0x00 0x01 0xbc 0x01 0x00 0x00 0x01 0x00 0x01 0xbd 0x01 0x00 0x00 0x01 0x00 0x01 0xbe 0x01 0x00 0x00 0x01 0x00 0x01 0xbf 0x00 0x00 0x00 0x01 0x00 0x00 0xc0 0x00 0x00 0x00 0x01 0x00 0x00 0xc1 0x00 0x00 0x00 0x01 0x00 0x00 0xc2 0x00 0x00 0x00 0x01 0x00 0x00 0xc3 0x00 0x00 0x00 0x01 0x00 0x00 0xc4 0x00 0x00 0x00 0x01 0x00 0x00 0xc5 0x00 0x00 0x00 0x01 0x00 0x00 0xc6 0x00 0x00 0x00 0x01 0x00 0x00 0xc7 0x00 0x00 0x00 0x01 0x00 0x00 0xc8 0x00 0x00 0x00 0x01 0x00 0x00 0xc9 0x00 0x00 0x00 0x01 0x00 0x00 0xca 0x00 0x00 0x00 0x01 0x00 0x00 0xcb 0x00 0x00 0x00 0x01 0x00 0x00 0xcc 0x00 0x00 0x00 0x01 0x00 0x00 0xcd 0x00 0x00 0x00 0x01 0x00 0x00 0xce 0x00 0x00 0x00 0x01 0x00 0x00 0xcf 0x00 0x00 0x00 0x01 0x00 0x00 0xd0 0x00 0x00 0x00 0x01 0x00 0x00 0xd1 0x00 0x00 0x00 0x01 0x00 0x00 0xd2 0x00 0x00 0x00 0x01 0x00 0x00 0xd3 0x00 0x00 0x00 0x01 0x00 0x00 0xd4 0x00 0x00 0x00 0x01 0x00 0x00 0xd5 0x00 0x00 0x00 0x01 0x00 0x00 0xd6 0x00 0x00 0x00 0x01 0x00 0x00 0xd7 0x00 0x00 0x00 0x01 0x00 0x00 0xd8 0x00 0x00 0x00 0x01 0x00 0x00 0xd9 0x00 0x00 0x00 0x01 0x00 0x00 0xda 0x00 0x00 0x00 0x01 0x00 0x00 0xdb 0x00 0x00 0x00 0x01 0x00 0x00 0xdc 0x00 0x00 0x00 0x01 0x00 0x00 0xdd 0x00 0x00 0x00 0x01 0x00 0x00>;
		};
	};

	fragment@40 {
		target = <0xffffffff>;

		__overlay__ {
			interrupt-parent = <0xffffffff>;
			interrupts = <0x04 0x02>;
			status = "okay";
		};
	};

	fragment@41 {
		target = <0xffffffff>;

		__overlay__ {
			interrupt-parent = <0xffffffff>;
			interrupts = <0x0f 0x02>;
			status = "okay";
		};
	};

	fragment@42 {
		target = <0xffffffff>;

		__overlay__ {
			interrupt-parent = <0xffffffff>;
			interrupts = <0x61 0x01>;
			status = "okay";
		};
	};

	fragment@43 {
		target = <0xffffffff>;

		__overlay__ {
			compatible = "mediatek,md1_sim1_hot_plug_eint-eint";
			interrupts = <0x00 0x08>;
			debounce = <0x00 0x2710>;
			dedicated = <0x00 0x00>;
			src_pin = <0x00 0x01>;
			sockettype = <0x00 0x00>;
			status = "okay";
		};
	};

	fragment@44 {
		target = <0xffffffff>;

		__overlay__ {
			mediatek,kpd-key-debounce = <0x400>;
			mediatek,kpd-sw-pwrkey = <0x74>;
			mediatek,kpd-hw-pwrkey = <0x08>;
			mediatek,kpd-use-extend-type = <0x00>;
			mediatek,kpd-hw-map-num = <0x48>;
			mediatek,kpd-hw-init-map = <0x73 0x72 0x00 0x00 0x00 0x00 0x00 0x00 0x00 0x00 0x00 0x00 0x00 0x00 0x00 0x00 0x00 0x00 0x00 0x00 0x00 0x00 0x00 0x00 0x00 0x00 0x00 0x00 0x00 0x00 0x00 0x00 0x00 0x00 0x00 0x00 0x00 0x00 0x00 0x00 0x00 0x00 0x00 0x00 0x00 0x00 0x00 0x00 0x00 0x00 0x00 0x00 0x00 0x00 0x00 0x00 0x00 0x00 0x00 0x00 0x00 0x00 0x00 0x00 0x00 0x00 0x00 0x00 0x00 0x00 0x00 0x00>;
			mediatek,kpd-pwrkey-eint-gpio = <0x00>;
			mediatek,kpd-pwkey-gpio-din = <0x00>;
			mediatek,kpd-hw-dl-key0 = <0x00>;
			mediatek,kpd-hw-dl-key1 = <0x01>;
			mediatek,kpd-hw-dl-key2 = <0x08>;
			mediatek,kpd-hw-recovery-key = <0x00>;
			mediatek,kpd-hw-factory-key = <0x01>;
			status = "okay";
		};
	};

	fragment@45 {
		target = <0xffffffff>;

		__overlay__ {

			cam0@0 {
				phandle = <0x30>;

				pins_cmd_dat {
					pinmux = <0x1400>;
					slew-rate = <0x01>;
					output-low;
				};
			};

			cam0@1 {
				phandle = <0x31>;

				pins_cmd_dat {
					pinmux = <0x1400>;
					slew-rate = <0x01>;
					output-high;
				};
			};

			cam1@0 {
				phandle = <0x32>;

				pins_cmd_dat {
					pinmux = <0x1200>;
					slew-rate = <0x01>;
					output-low;
				};
			};

			cam1@1 {
				phandle = <0x33>;

				pins_cmd_dat {
					pinmux = <0x1200>;
					slew-rate = <0x01>;
					output-high;
				};
			};

			cam2@0 {
				phandle = <0x34>;

				pins_cmd_dat {
					pinmux = <0x1a00>;
					slew-rate = <0x01>;
					output-low;
				};
			};

			cam2@1 {
				phandle = <0x35>;

				pins_cmd_dat {
					pinmux = <0x1a00>;
					slew-rate = <0x01>;
					output-high;
				};
			};

			cam3@0 {
				phandle = <0x36>;

				pins_cmd_dat {
					pinmux = <0x1600>;
					slew-rate = <0x01>;
					output-low;
				};
			};

			cam3@1 {
				phandle = <0x37>;

				pins_cmd_dat {
					pinmux = <0x1600>;
					slew-rate = <0x01>;
					output-high;
				};
			};

			cam3@2 {
				phandle = <0x38>;

				pins_cmd_dat {
					pinmux = <0x1300>;
					slew-rate = <0x01>;
					output-low;
				};
			};

			cam3@3 {
				phandle = <0x39>;

				pins_cmd_dat {
					pinmux = <0x1300>;
					slew-rate = <0x01>;
					output-high;
				};
			};

			cam0@vcam0 {
				phandle = <0x3a>;

				pins_cmd_dat {
					pinmux = <0x3600>;
					slew-rate = <0x01>;
					output-low;
				};
			};

			cam0@vcam1 {
				phandle = <0x3b>;

				pins_cmd_dat {
					pinmux = <0x3600>;
					slew-rate = <0x01>;
					output-high;
				};
			};

			cam1@vcam0 {
				phandle = <0x3c>;

				pins_cmd_dat {
					pinmux = <0x3600>;
					slew-rate = <0x01>;
					output-low;
				};
			};

			cam1@vcam1 {
				phandle = <0x3d>;

				pins_cmd_dat {
					pinmux = <0x3600>;
					slew-rate = <0x01>;
					output-high;
				};
			};

			cam2@vcam0 {
				phandle = <0x3e>;

				pins_cmd_dat {
					pinmux = <0x3600>;
					slew-rate = <0x01>;
					output-low;
				};
			};

			cam2@vcam1 {
				phandle = <0x3f>;

				pins_cmd_dat {
					pinmux = <0x3600>;
					slew-rate = <0x01>;
					output-high;
				};
			};

			cam3@vcam0 {
				phandle = <0x40>;

				pins_cmd_dat {
					pinmux = <0x3600>;
					slew-rate = <0x01>;
					output-low;
				};
			};

			cam3@vcam1 {
				phandle = <0x41>;

				pins_cmd_dat {
					pinmux = <0x3600>;
					slew-rate = <0x01>;
					output-high;
				};
			};

			camera_pins_cam0_mclk_off {
				phandle = <0x42>;

				pins_cmd_dat {
					pinmux = <0x8d00>;
					drive-strength = <0x01>;
				};
			};

			camera_pins_cam0_mclk_2ma {
				phandle = <0x43>;

				pins_cmd_dat {
					pinmux = <0x8d01>;
					drive-strength = <0x00>;
				};
			};

			camera_pins_cam0_mclk_4ma {
				phandle = <0x44>;

				pins_cmd_dat {
					pinmux = <0x8d01>;
					drive-strength = <0x01>;
				};
			};

			camera_pins_cam0_mclk_6ma {
				phandle = <0x45>;

				pins_cmd_dat {
					pinmux = <0x8d01>;
					drive-strength = <0x02>;
				};
			};

			camera_pins_cam0_mclk_8ma {
				phandle = <0x46>;

				pins_cmd_dat {
					pinmux = <0x8d01>;
					drive-strength = <0x03>;
				};
			};

			camera_pins_cam1_mclk_off {
				phandle = <0x47>;

				pins_cmd_dat {
					pinmux = <0x8c00>;
					drive-strength = <0x01>;
				};
			};

			camera_pins_cam1_mclk_2ma {
				phandle = <0x48>;

				pins_cmd_dat {
					pinmux = <0x8c01>;
					drive-strength = <0x00>;
				};
			};

			camera_pins_cam1_mclk_4ma {
				phandle = <0x49>;

				pins_cmd_dat {
					pinmux = <0x8c01>;
					drive-strength = <0x01>;
				};
			};

			camera_pins_cam1_mclk_6ma {
				phandle = <0x4a>;

				pins_cmd_dat {
					pinmux = <0x8c01>;
					drive-strength = <0x02>;
				};
			};

			camera_pins_cam1_mclk_8ma {
				phandle = <0x4b>;

				pins_cmd_dat {
					pinmux = <0x8c01>;
					drive-strength = <0x03>;
				};
			};

			camera_pins_cam2_mclk_off {
				phandle = <0x4c>;

				pins_cmd_dat {
					pinmux = <0x3c00>;
					drive-strength = <0x01>;
				};
			};

			camera_pins_cam2_mclk_2ma {
				phandle = <0x4d>;

				pins_cmd_dat {
					pinmux = <0x3c03>;
					drive-strength = <0x00>;
				};
			};

			camera_pins_cam2_mclk_4ma {
				phandle = <0x4e>;

				pins_cmd_dat {
					pinmux = <0x3c03>;
					drive-strength = <0x01>;
				};
			};

			camera_pins_cam2_mclk_6ma {
				phandle = <0x4f>;

				pins_cmd_dat {
					pinmux = <0x3c03>;
					drive-strength = <0x02>;
				};
			};

			camera_pins_cam2_mclk_8ma {
				phandle = <0x50>;

				pins_cmd_dat {
					pinmux = <0x3c03>;
					drive-strength = <0x03>;
				};
			};

			camera_pins_cam3_mclk_off {
				phandle = <0x51>;

				pins_cmd_dat {
					pinmux = <0x8e00>;
					drive-strength = <0x01>;
				};
			};

			camera_pins_cam3_mclk_2ma {
				phandle = <0x52>;

				pins_cmd_dat {
					pinmux = <0x8e01>;
					drive-strength = <0x00>;
				};
			};

			camera_pins_cam3_mclk_4ma {
				phandle = <0x53>;

				pins_cmd_dat {
					pinmux = <0x8e01>;
					drive-strength = <0x01>;
				};
			};

			camera_pins_cam3_mclk_6ma {
				phandle = <0x54>;

				pins_cmd_dat {
					pinmux = <0x8e01>;
					drive-strength = <0x02>;
				};
			};

			camera_pins_cam3_mclk_8ma {
				phandle = <0x55>;

				pins_cmd_dat {
					pinmux = <0x8e01>;
					drive-strength = <0x03>;
				};
			};

			camdefault {
				phandle = <0x2f>;
			};
		};
	};

	fragment@46 {
		target = <0xffffffff>;

		__overlay__ {
			pinctrl-names = "default\0cam0_rst0\0cam0_rst1\0cam1_rst0\0cam1_rst1\0cam2_rst0\0cam2_rst1\0cam3_rst0\0cam3_rst1\0cam3_pnd0\0cam3_pnd1\0cam0_ldo_vcamio_0\0cam0_ldo_vcamio_1\0cam1_ldo_vcamio_0\0cam1_ldo_vcamio_1\0cam2_ldo_vcamio_0\0cam2_ldo_vcamio_1\0cam3_ldo_vcamio_0\0cam3_ldo_vcamio_1\0cam0_mclk_off\0cam0_mclk_2mA\0cam0_mclk_4mA\0cam0_mclk_6mA\0cam0_mclk_8mA\0cam1_mclk_off\0cam1_mclk_2mA\0cam1_mclk_4mA\0cam1_mclk_6mA\0cam1_mclk_8mA\0cam2_mclk_off\0cam2_mclk_2mA\0cam2_mclk_4mA\0cam2_mclk_6mA\0cam2_mclk_8mA\0cam3_mclk_off\0cam3_mclk_2mA\0cam3_mclk_4mA\0cam3_mclk_6mA\0cam3_mclk_8mA";
			pinctrl-0 = <0x2f>;
			pinctrl-1 = <0x30>;
			pinctrl-2 = <0x31>;
			pinctrl-3 = <0x32>;
			pinctrl-4 = <0x33>;
			pinctrl-5 = <0x34>;
			pinctrl-6 = <0x35>;
			pinctrl-7 = <0x36>;
			pinctrl-8 = <0x37>;
			pinctrl-9 = <0x38>;
			pinctrl-10 = <0x39>;
			pinctrl-11 = <0x3a>;
			pinctrl-12 = <0x3b>;
			pinctrl-13 = <0x3c>;
			pinctrl-14 = <0x3d>;
			pinctrl-15 = <0x3e>;
			pinctrl-16 = <0x3f>;
			pinctrl-17 = <0x40>;
			pinctrl-18 = <0x41>;
			pinctrl-19 = <0x42>;
			pinctrl-20 = <0x43>;
			pinctrl-21 = <0x44>;
			pinctrl-22 = <0x45>;
			pinctrl-23 = <0x46>;
			pinctrl-24 = <0x47>;
			pinctrl-25 = <0x48>;
			pinctrl-26 = <0x49>;
			pinctrl-27 = <0x4a>;
			pinctrl-28 = <0x4b>;
			pinctrl-29 = <0x4c>;
			pinctrl-30 = <0x4d>;
			pinctrl-31 = <0x4e>;
			pinctrl-32 = <0x4f>;
			pinctrl-33 = <0x50>;
			pinctrl-34 = <0x51>;
			pinctrl-35 = <0x52>;
			pinctrl-36 = <0x53>;
			pinctrl-37 = <0x54>;
			pinctrl-38 = <0x55>;
			status = "okay";
		};
	};

	fragment@47 {
		target = <0xffffffff>;

		__overlay__ {

			extldodefault {
				phandle = <0x01>;
			};

			extldo_en_high {
				phandle = <0x02>;

				pins_cmd_dat {
					pinmux = <0x3d00>;
					output-high;
				};
			};

			extldo_en_low {
				phandle = <0x03>;

				pins_cmd_dat {
					pinmux = <0x3d00>;
					output-low;
				};
			};
		};
	};

	fragment@48 {
		target = <0xffffffff>;

		__overlay__ {
			#address-cells = <0x01>;
			#size-cells = <0x00>;
			clock-frequency = <0x61a80>;
			mediatek,use-open-drain;

			cam_vdd_ext@28 {
				compatible = "mediatek,cam_vdd_ext";
				reg = <0x28>;
				status = "okay";
			};
		};
	};

	fragment@49 {
		target = <0xffffffff>;

		__overlay__ {

			aw36515default {
				phandle = <0x04>;
			};

			aw36515hwen_high {
				phandle = <0x05>;

				pins_cmd_dat {
					pinmux = <0xa800>;
					slew-rate = <0x01>;
					output-high;
				};
			};

			aw36515hwen_low {
				phandle = <0x06>;

				pins_cmd_dat {
					pinmux = <0xa800>;
					slew-rate = <0x01>;
					output-low;
				};
			};
		};
	};

	fragment@50 {
		target = <0xffffffff>;

		__overlay__ {

			ocp81375default {
				phandle = <0x07>;
			};

			ocp81375hwen_high {
				phandle = <0x08>;

				pins_cmd_dat {
					pinmux = <0xa800>;
					slew-rate = <0x01>;
					output-high;
				};
			};

			ocp81375hwen_low {
				phandle = <0x09>;

				pins_cmd_dat {
					pinmux = <0xa800>;
					slew-rate = <0x01>;
					output-low;
				};
			};
		};
	};

	fragment@51 {
		target = <0xffffffff>;

		__overlay__ {

			camera_eeprom0@50 {
				compatible = "mediatek,camera_eeprom";
				reg = <0x50>;
				status = "okay";
				phandle = <0x74>;
			};
		};
	};

	fragment@52 {
		target = <0xffffffff>;

		__overlay__ {

			camera_eeprom1@51 {
				compatible = "mediatek,camera_eeprom";
				reg = <0x51>;
				status = "okay";
				phandle = <0x75>;
			};
		};
	};

	fragment@53 {
		target = <0xffffffff>;

		__overlay__ {

			camera_eeprom2@55 {
				compatible = "mediatek,camera_eeprom";
				reg = <0x55>;
				status = "okay";
				phandle = <0x76>;
			};
		};
	};

	fragment@54 {
		target = <0xffffffff>;

		__overlay__ {

			cam0vcamafdefault {
				phandle = <0x0a>;
			};

			cam0_ldo_vcamaf_1 {
				phandle = <0x0b>;

				pins_cmd_dat {
					pinmux = <0x4200>;
					slew-rate = <0x01>;
					output-high;
				};
			};

			cam0_ldo_vcamaf_0 {
				phandle = <0x0c>;

				pins_cmd_dat {
					pinmux = <0x4200>;
					slew-rate = <0x01>;
					output-low;
				};
			};
		};
	};

	fragment@55 {
		target = <0xffffffff>;

		__overlay__ {
			#address-cells = <0x01>;
			#size-cells = <0x00>;

			rt9759_slave@66 {
				compatible = "richtek,rt9759";
				status = "okay";
				reg = <0x66>;
				rm_name = "rt9759";
				rm_slave_addr = [65];
				rt9759,intr-gpios = <0xffffffff 0x06 0x00>;

				standalone {
					chg_name = "primary_divider_chg";
					vbatovp = <0x456d70>;
					vbatovp_alm = <0x43e6d0>;
					ibatocp = <0x6c5660>;
					ibatocp_alm = <0x6acfc0>;
					ibatucp_alm = <0xf4240>;
					vbusovp = <0xa7d8c0>;
					vbusovp_alm = <0xa037a0>;
					ibusocp = <0x40d990>;
					ibusocp_alm = "\0=\t";
					vacovp = <0xa7d8c0>;
					wdt = <0x1c9c380>;
					ibat_rsense = <0x01>;
					ibatocp_alm_dis;
					ibatucp_alm_dis;
					ibusocp_alm_dis;
				};

				slave {
					chg_name = "secondary_divider_chg";
					vbatovp = <0x44aa20>;
					vbatovp_alm = <0x432380>;
					ibatocp = <0x5d1420>;
					ibatocp_alm = <0x5b8d80>;
					ibatucp_alm = <0xf4240>;
					vbusovp = <0x989680>;
					vbusovp_alm = <0x895440>;
					ibusocp = <0x40d990>;
					ibusocp_alm = "\0=\t";
					vacovp = <0xa7d8c0>;
					wdt = <0xf4240>;
					ibat_rsense = <0x01>;
					vbatovp_dis;
					vbatovp_alm_dis;
					ibatocp_dis;
					ibatocp_alm_dis;
					ibatucp_alm_dis;
					vbusovp_alm_dis;
					ibusocp_alm_dis;
					wdt_dis;
					vbatadc_dis;
					ibatadc_dis;
				};
			};

			rt9759_master@66 {
				compatible = "richtek,rt9759";
				status = "okay";
				reg = <0x66>;
				rm_name = "rt9759";
				rm_slave_addr = [65];
				rt9759,intr-gpios = <0xffffffff 0x06 0x00>;

				standalone {
					chg_name = "primary_divider_chg";
					vbatovp = <0x456d70>;
					vbatovp_alm = <0x43e6d0>;
					ibatocp = <0x6c5660>;
					ibatocp_alm = <0x6acfc0>;
					ibatucp_alm = <0xf4240>;
					vbusovp = <0xa7d8c0>;
					vbusovp_alm = <0xa037a0>;
					ibusocp = <0x40d990>;
					ibusocp_alm = "\0=\t";
					vacovp = <0xa7d8c0>;
					wdt = <0x1c9c380>;
					ibat_rsense = <0x01>;
					ibatocp_alm_dis;
					ibatucp_alm_dis;
					ibusocp_alm_dis;
				};

				master {
					chg_name = "primary_divider_chg";
					vbatovp = <0x44aa20>;
					vbatovp_alm = <0x432380>;
					ibatocp = <0x5d1420>;
					ibatocp_alm = <0x5b8d80>;
					ibatucp_alm = <0xf4240>;
					vbusovp = <0x989680>;
					vbusovp_alm = <0x895440>;
					ibusocp = <0x40d990>;
					ibusocp_alm = "\0=\t";
					vacovp = <0xa7d8c0>;
					wdt = <0x1c9c380>;
					ibat_rsense = <0x01>;
					ibatocp_alm_dis;
					ibusocp_alm_dis;
					tsbusotp_dis;
					tsbatotp_dis;
					tsbusadc_dis;
					tsbatadc_dis;
				};
			};
		};
	};

	fragment@56 {
		target = <0xffffffff>;

		__overlay__ {

			mtk_pe50 {
				polling_interval = <0x2710>;
				ta_cv_ss_repeat_tmin = <0x19>;
				vbat_cv = <0x1176>;
				start_soc_min = <0x01>;
				start_soc_max = <0x5a>;
				start_vbat_max = <0x1144>;
				idvchg_term = <0x1f4>;
				idvchg_step = <0x32>;
				ita_level = <0xbb8 0x8ca 0x7d0 0x5dc>;
				rcable_level = <0x190 0x1c2 0x226 0x2bc>;
				ita_level_dual = <0xfa0 0xe74 0xd48 0xbb8>;
				rcable_level_dual = <0xbc 0xcb 0xdd 0xfa>;
				idvchg_ss_init = <0x4b0>;
				idvchg_ss_step = <0xfa>;
				idvchg_ss_step1 = <0x64>;
				idvchg_ss_step2 = <0x32>;
				idvchg_ss_step1_vbat = <0xfa0>;
				idvchg_ss_step2_vbat = <0x1068>;
				ta_blanking = <0x190>;
				swchg_aicr = <0x00>;
				swchg_ichg = <0x4b0>;
				swchg_aicr_ss_init = <0x190>;
				swchg_aicr_ss_step = <0xc8>;
				swchg_off_vbat = <0x109a>;
				force_ta_cv_vbat = <0x1130>;
				chg_time_max = <0x1518>;
				tta_level_def = <0x00 0x00 0x00 0x00 0x19 0x46 0x50 0x5a 0x5f>;
				tta_curlmt = <0x00 0x00 0x00 0x00 0x00 0x12c 0x258 0x384 0xffffffff>;
				tta_recovery_area = <0x03>;
				tbat_level_def = <0x00 0x00 0x0d 0x0f 0x19 0x29 0x2a 0x2b 0x2d>;
				tbat_curlmt = <0xffffffff 0xffffffff 0xffffffff 0x3e8 0x00 0xfa 0x2ee 0x4e2 0xffffffff>;
				tbat_recovery_area = <0x03>;
				tdvchg_level_def = <0x00 0x00 0x00 0x05 0x19 0x46 0x4b 0x50 0x55>;
				tdvchg_curlmt = <0xffffffff 0xffffffff 0xffffffff 0x12c 0x00 0x12c 0x258 0x384 0xffffffff>;
				tdvchg_recovery_area = <0x03>;
				tswchg_level_def = <0x00 0x00 0x00 0x05 0x19 0x41 0x46 0x4b 0x50>;
				tswchg_curlmt = <0xffffffff 0xffffffff 0xffffffff 0xc8 0x00 0xc8 0x12c 0x190 0xffffffff>;
				tswchg_recovery_area = <0x03>;
				ifod_threshold = <0xc8>;
				rsw_min = <0x14>;
				ircmp_rbat = <0x05>;
				ircmp_vclamp = <0x0a>;
				vta_cap_min = <0x1a90>;
				vta_cap_max = <0x2904>;
				ita_cap_min = <0x3e8>;
				vbus_max_ovp = <0x2af8>;
				ibat_max = <0x1b58>;
				cv_reduce_step = <0x03>;
				support_ta = "pca_ta_pps\0pca_ta_rfc";
				allow_not_check_ta_status;
				rechg_ab_h = <0x29 0xffffffff 0xffffffff 0xffffffff 0xffffffff 0xffffffff>;
				rechg_ab_l = <0x0f 0xffffffff 0xffffffff 0xffffffff 0xffffffff 0xffffffff>;
				dv2_ab_dev = <0x00 0x00 0x00 0x00 0x00 0x00>;
				dv2_ffc_vbat = <0x1004 0x1180 0x1180>;
				dv2_ffc_ibat = <0xbb8 0x8ca 0x8ca>;
				tpcb_level_def = <0x00 0x00 0x00 0x00 0x19 0x2b 0x2c 0x2d 0x5a>;
				tpcb_curlmt = <0x00 0x00 0x00 0x00 0x00 0x1f4 0x3e8 0x5dc 0xffffffff>;
				tusb_level_def = <0x00 0x00 0x00 0x00 0x19 0x41 0x46 0x50 0x5a>;
				tusb_curlmt = <0x00 0x00 0x00 0x00 0x00 0x00 0x00 0x00 0xffffffff>;
				idvchg_pps_term = <0x4b0>;
				game_limit_ita = <0x5dc>;
			};
		};
	};

	fragment@57 {
		target = <0xffffffff>;

		__overlay__ {

			rt-swchg@53 {
				compatible = "richtek,swchg";
				reg = <0x53>;
				status = "okay";
				rt,intr_gpio_num = <0x04>;
				rt,intr_gpio = <0xffffffff 0x04 0x00>;
				hvdcp20_dp_gpio = <0xffffffff 0xa6 0x00>;
				tc30_dm_gpio = <0xffffffff 0xad 0x00>;

				rt9471 {
					charger_name = "primary_chg";
					chg_alias_name = "rt9471_chg";
					rm-slave-addr = [53];
					rm-name = "rt9471";
					interrupt-names = "wdt\0chg_mivr\0vac_ov\0otg_fault\0chg_rdy\0chg_done\0aicc_done\0pe_done\0chg_tout\0ieoc\0rechg\0chg_batov";
					vac_ovp = <0xd59f80>;
					mivr = <0x432380>;
					aicr = <0x7a120>;
					cv = <0x43e6d0>;
					ichg = <0x16e360>;
					ieoc = <0x30d40>;
					safe_tmr = <0x0a>;
					wdt = <0x28>;
					mivr_track = <0x00>;
					en_safe_tmr;
					en_te;
					en_qon_rst;
				};
			};
		};
	};

	__symbols__ {
		cam_vdd_ext = "/fragment@2/__overlay__/cam_vdd_ext";
		flashlights_aw36515 = "/fragment@2/__overlay__/flashlights_aw36515";
		flashlights_ocp81375 = "/fragment@2/__overlay__/flashlights_ocp81375";
		lens_actuator_main_af = "/fragment@2/__overlay__/lens_actuator_main_af";
		led0 = "/fragment@2/__overlay__/led@0";
		led1 = "/fragment@2/__overlay__/led@1";
		led2 = "/fragment@2/__overlay__/led@2";
		led3 = "/fragment@2/__overlay__/led@3";
		led4 = "/fragment@2/__overlay__/led@4";
		led5 = "/fragment@2/__overlay__/led@5";
		led6 = "/fragment@2/__overlay__/led@6";
		vibrator0 = "/fragment@2/__overlay__/vibrator@0";
		tran_audio = "/fragment@2/__overlay__/tran_audio";
		usb_c_pinctrl = "/fragment@2/__overlay__/usb_c_pinctrl";
		fingerprint = "/fragment@2/__overlay__/fingerprint";
		fingerprint_default = "/fragment@4/__overlay__/fingerprint_default";
		fingerprint_eint = "/fragment@4/__overlay__/gpio1_eint";
		fingerprint_eint_pull_down = "/fragment@4/__overlay__/gpio1_eint_pull_down";
		fingerprint_rst_one = "/fragment@4/__overlay__/rst_out_one";
		fingerprint_rst_zero = "/fragment@4/__overlay__/rst_out_zero";
		fingerprint_spi_default = "/fragment@4/__overlay__/spimode_default";
		ctp_pins_default = "/fragment@6/__overlay__/eint0default";
		ctp_pins_eint_as_int = "/fragment@6/__overlay__/eint@0";
		ctp_pins_eint_output0 = "/fragment@6/__overlay__/eintoutput0";
		ctp_pins_eint_output1 = "/fragment@6/__overlay__/eintoutput1";
		ctp_pins_rst_output0 = "/fragment@6/__overlay__/rstoutput0";
		ctp_pins_rst_output1 = "/fragment@6/__overlay__/rstoutput1";
		tran_touch = "/fragment@7/__overlay__/touch@0";
		gps_pins_default = "/fragment@9/__overlay__/gps_default";
		gps_l1_lna_pins_ol = "/fragment@9/__overlay__/gps_l1_lna@0";
		gps_l1_lna_pins_dsp_ctrl = "/fragment@9/__overlay__/gps_l1_lna@1";
		gps_l1_lna_pins_oh = "/fragment@9/__overlay__/gps_l1_lna@2";
		gps_l5_lna_pins_ol = "/fragment@9/__overlay__/gps_l5_lna@0";
		gps_l5_lna_pins_dsp_ctrl = "/fragment@9/__overlay__/gps_l5_lna@1";
		gps_l5_lna_pins_oh = "/fragment@9/__overlay__/gps_l5_lna@2";
		dv2_usb_switch_pins_default1 = "/fragment@13/__overlay__/dualdefault1";
		dv2_usb_switch_pins_high1 = "/fragment@13/__overlay__/dv2_high1";
		dv2_usb_switch_pins_low1 = "/fragment@13/__overlay__/dv2_low1";
		dv2_usb_switch_pins_default2 = "/fragment@13/__overlay__/dualdefault2";
		dv2_usb_switch_pins_high2 = "/fragment@13/__overlay__/dv2_high2";
		dv2_usb_switch_pins_low2 = "/fragment@13/__overlay__/dv2_low2";
		rfc_sda8_pins = "/fragment@13/__overlay__/dv2_i2c_sda8";
		rfc_scl8_pins = "/fragment@13/__overlay__/dv2_i2c_scl8";
		mtkfb_pins_lcm_rst_out1_gpio = "/fragment@15/__overlay__/lcm_rst_out1_gpio";
		mtkfb_pins_lcm_rst_out0_gpio = "/fragment@15/__overlay__/lcm_rst_out0_gpio";
		mtkfb_pins_lcm_dsi_te = "/fragment@15/__overlay__/lcm_dsi_te";
		panel_in1 = "/fragment@18/__overlay__/panel1@0/port/endpoint";
		dsi_out = "/fragment@18/__overlay__/ports/port/endpoint";
		irtx_gpio_led_default = "/fragment@20/__overlay__/irtx_gpio_led_def@gpio42";
		irtx_gpio_led_set = "/fragment@20/__overlay__/irtx_gpio_led_set@gpio42";
		otg_iddig = "/fragment@21/__overlay__/otg_iddig";
		tran_battery = "/fragment@21/__overlay__/tran_battery";
		tran_battery_aging = "/fragment@21/__overlay__/tran_battery_aging";
		usb_switch = "/fragment@21/__overlay__/usb_switch";
		camera_main_mtk = "/fragment@30/__overlay__/camera_main@10";
		camera_main_af_mtk = "/fragment@30/__overlay__/camera_main_af@0c";
		camera_sub_mtk = "/fragment@30/__overlay__/camera_sub@20";
		strobe_main_mtk = "/fragment@31/__overlay__/strobe_main@63";
		nfc_mtk = "/fragment@31/__overlay__/nfc@08";
		camera_sub_two_mtk = "/fragment@32/__overlay__/camera_sub_two@10";
		subpmic_pmu_mtk = "/fragment@33/__overlay__/subpmic_pmu@34";
		usb_type_c_mtk = "/fragment@33/__overlay__/usb_type_c@4e";
		i2c_lcd_bias_mtk = "/fragment@34/__overlay__/i2c_lcd_bias@3e";
		camera_main_two_mtk = "/fragment@36/__overlay__/camera_main_two@10";
		camera_pins_cam0_rst_0 = "/fragment@45/__overlay__/cam0@0";
		camera_pins_cam0_rst_1 = "/fragment@45/__overlay__/cam0@1";
		camera_pins_cam1_rst_0 = "/fragment@45/__overlay__/cam1@0";
		camera_pins_cam1_rst_1 = "/fragment@45/__overlay__/cam1@1";
		camera_pins_cam2_rst_0 = "/fragment@45/__overlay__/cam2@0";
		camera_pins_cam2_rst_1 = "/fragment@45/__overlay__/cam2@1";
		camera_pins_cam3_rst_0 = "/fragment@45/__overlay__/cam3@0";
		camera_pins_cam3_rst_1 = "/fragment@45/__overlay__/cam3@1";
		camera_pins_cam3_pnd_0 = "/fragment@45/__overlay__/cam3@2";
		camera_pins_cam3_pnd_1 = "/fragment@45/__overlay__/cam3@3";
		camera_pins_cam0_vcamio_0 = "/fragment@45/__overlay__/cam0@vcam0";
		camera_pins_cam0_vcamio_1 = "/fragment@45/__overlay__/cam0@vcam1";
		camera_pins_cam1_vcamio_0 = "/fragment@45/__overlay__/cam1@vcam0";
		camera_pins_cam1_vcamio_1 = "/fragment@45/__overlay__/cam1@vcam1";
		camera_pins_cam2_vcamio_0 = "/fragment@45/__overlay__/cam2@vcam0";
		camera_pins_cam2_vcamio_1 = "/fragment@45/__overlay__/cam2@vcam1";
		camera_pins_cam3_vcamio_0 = "/fragment@45/__overlay__/cam3@vcam0";
		camera_pins_cam3_vcamio_1 = "/fragment@45/__overlay__/cam3@vcam1";
		camera_pins_cam0_mclk_off = "/fragment@45/__overlay__/camera_pins_cam0_mclk_off";
		camera_pins_cam0_mclk_2ma = "/fragment@45/__overlay__/camera_pins_cam0_mclk_2ma";
		camera_pins_cam0_mclk_4ma = "/fragment@45/__overlay__/camera_pins_cam0_mclk_4ma";
		camera_pins_cam0_mclk_6ma = "/fragment@45/__overlay__/camera_pins_cam0_mclk_6ma";
		camera_pins_cam0_mclk_8ma = "/fragment@45/__overlay__/camera_pins_cam0_mclk_8ma";
		camera_pins_cam1_mclk_off = "/fragment@45/__overlay__/camera_pins_cam1_mclk_off";
		camera_pins_cam1_mclk_2ma = "/fragment@45/__overlay__/camera_pins_cam1_mclk_2ma";
		camera_pins_cam1_mclk_4ma = "/fragment@45/__overlay__/camera_pins_cam1_mclk_4ma";
		camera_pins_cam1_mclk_6ma = "/fragment@45/__overlay__/camera_pins_cam1_mclk_6ma";
		camera_pins_cam1_mclk_8ma = "/fragment@45/__overlay__/camera_pins_cam1_mclk_8ma";
		camera_pins_cam2_mclk_off = "/fragment@45/__overlay__/camera_pins_cam2_mclk_off";
		camera_pins_cam2_mclk_2ma = "/fragment@45/__overlay__/camera_pins_cam2_mclk_2ma";
		camera_pins_cam2_mclk_4ma = "/fragment@45/__overlay__/camera_pins_cam2_mclk_4ma";
		camera_pins_cam2_mclk_6ma = "/fragment@45/__overlay__/camera_pins_cam2_mclk_6ma";
		camera_pins_cam2_mclk_8ma = "/fragment@45/__overlay__/camera_pins_cam2_mclk_8ma";
		camera_pins_cam3_mclk_off = "/fragment@45/__overlay__/camera_pins_cam3_mclk_off";
		camera_pins_cam3_mclk_2ma = "/fragment@45/__overlay__/camera_pins_cam3_mclk_2ma";
		camera_pins_cam3_mclk_4ma = "/fragment@45/__overlay__/camera_pins_cam3_mclk_4ma";
		camera_pins_cam3_mclk_6ma = "/fragment@45/__overlay__/camera_pins_cam3_mclk_6ma";
		camera_pins_cam3_mclk_8ma = "/fragment@45/__overlay__/camera_pins_cam3_mclk_8ma";
		camera_pins_default = "/fragment@45/__overlay__/camdefault";
		ext_ldo_pins_default = "/fragment@47/__overlay__/extldodefault";
		ext_ldo_pins_hwen_high = "/fragment@47/__overlay__/extldo_en_high";
		ext_ldo_pins_hwen_low = "/fragment@47/__overlay__/extldo_en_low";
		flashlights_aw36515_pins_default = "/fragment@49/__overlay__/aw36515default";
		flashlights_aw36515_pins_hwen_high = "/fragment@49/__overlay__/aw36515hwen_high";
		flashlights_aw36515_pins_hwen_low = "/fragment@49/__overlay__/aw36515hwen_low";
		flashlights_ocp81375_pins_default = "/fragment@50/__overlay__/ocp81375default";
		flashlights_ocp81375_pins_hwen_high = "/fragment@50/__overlay__/ocp81375hwen_high";
		flashlights_ocp81375_pins_hwen_low = "/fragment@50/__overlay__/ocp81375hwen_low";
		mtk_camera_eeprom0 = "/fragment@51/__overlay__/camera_eeprom0@50";
		mtk_camera_eeprom1 = "/fragment@52/__overlay__/camera_eeprom1@51";
		mtk_camera_eeprom2 = "/fragment@53/__overlay__/camera_eeprom2@55";
		cam0_ldo_vcamaf_default = "/fragment@54/__overlay__/cam0vcamafdefault";
		cam0_ldo_vcamaf_high = "/fragment@54/__overlay__/cam0_ldo_vcamaf_1";
		cam0_ldo_vcamaf_low = "/fragment@54/__overlay__/cam0_ldo_vcamaf_0";
	};

	__fixups__ {
		reserved_memory = "/fragment@0:target:0";
		chosen = "/fragment@1:target:0";
		odm = "/fragment@2:target:0\0/fragment@21:target:0\0/fragment@56:target:0";
		pio = "/fragment@2/__overlay__/tran_audio:extamp_gpio:0\0/fragment@2/__overlay__/tran_audio:dual_speaker_gpio:0\0/fragment@2/__overlay__/fingerprint:interrupt-parent:0\0/fragment@3/__overlay__/fingerprint@0:interrupt-parent:0\0/fragment@3/__overlay__/fingerprint@0:irq-gpio-std:0\0/fragment@3/__overlay__/fingerprint@0:reset-gpio-std:0\0/fragment@4:target:0\0/fragment@6:target:0\0/fragment@8/__overlay__/awinic_haptic@58:reset-gpio:0\0/fragment@8/__overlay__/awinic_haptic@58:irq-gpio:0\0/fragment@9:target:0\0/fragment@13:target:0\0/fragment@15:target:0\0/fragment@18/__overlay__/panel1@0:reset-gpios:0\0/fragment@18/__overlay__/panel1@0:bias-gpios:0\0/fragment@18/__overlay__/panel1@0:bias-gpios:12\0/fragment@20:target:0\0/fragment@21/__overlay__/otg_iddig:interrupt-parent:0\0/fragment@21/__overlay__/usb_switch:rfc,sda8_gpio:0\0/fragment@21/__overlay__/usb_switch:rfc,scl8_gpio:0\0/fragment@38/__overlay__:GPIO_SIM1_HOT_PLUG:0\0/fragment@38/__overlay__:GPIO_SIM1_SCLK:0\0/fragment@38/__overlay__:GPIO_SIM1_SRST:0\0/fragment@38/__overlay__:GPIO_SIM1_SIO:0\0/fragment@38/__overlay__:GPIO_SIM2_SCLK:0\0/fragment@38/__overlay__:GPIO_SIM2_SRST:0\0/fragment@38/__overlay__:GPIO_SIM2_SIO:0\0/fragment@40/__overlay__:interrupt-parent:0\0/fragment@41/__overlay__:interrupt-parent:0\0/fragment@42/__overlay__:interrupt-parent:0\0/fragment@45:target:0\0/fragment@47:target:0\0/fragment@49:target:0\0/fragment@50:target:0\0/fragment@54:target:0\0/fragment@55/__overlay__/rt9759_slave@66:rt9759,intr-gpios:0\0/fragment@55/__overlay__/rt9759_master@66:rt9759,intr-gpios:0\0/fragment@57/__overlay__/rt-swchg@53:rt,intr_gpio:0\0/fragment@57/__overlay__/rt-swchg@53:hvdcp20_dp_gpio:0\0/fragment@57/__overlay__/rt-swchg@53:tc30_dm_gpio:0";
		spi0 = "/fragment@3:target:0";
		mt_pmic_vtp_ldo_reg = "/fragment@3/__overlay__/fingerprint@0:vmch-supply:0";
		touch = "/fragment@5:target:0\0/fragment@41:target:0";
		spi3 = "/fragment@7:target:0";
		i2c9 = "/fragment@8:target:0\0/fragment@37:target:0\0/fragment@48:target:0";
		kd_camera_hw1 = "/fragment@10:target:0\0/fragment@46:target:0";
		gps = "/fragment@11:target:0";
		i2c2 = "/fragment@12:target:0\0/fragment@30:target:0\0/fragment@51:target:0\0/fragment@52:target:0";
		accdet = "/fragment@14:target:0";
		mtkfb = "/fragment@16:target:0";
		dispsys_config = "/fragment@17:target:0";
		dsi0 = "/fragment@18:target:0";
		irtx_pwm = "/fragment@19:target:0";
		auxadc = "/fragment@21/__overlay__/otg_iddig:io-channels:0\0/fragment@25:target:0\0/fragment@26/__overlay__:io-channels:0";
		i2c7 = "/fragment@22:target:0\0/fragment@35:target:0";
		charger = "/fragment@23:target:0";
		lk_charger = "/fragment@24:target:0";
		md_auxadc = "/fragment@26:target:0";
		pmic_clock_buffer_ctrl = "/fragment@27:target:0";
		i2c0 = "/fragment@28:target:0";
		i2c1 = "/fragment@29:target:0";
		i2c3 = "/fragment@31:target:0";
		i2c4 = "/fragment@32:target:0\0/fragment@53:target:0";
		i2c5 = "/fragment@33:target:0\0/fragment@55:target:0\0/fragment@57:target:0";
		i2c6 = "/fragment@34:target:0";
		i2c8 = "/fragment@36:target:0";
		gpio_usage_mapping = "/fragment@38:target:0";
		gpio = "/fragment@39:target:0";
		subpmic_pmu_eint = "/fragment@40:target:0";
		dsi_te = "/fragment@42:target:0";
		md1_sim1_hot_plug_eint = "/fragment@43:target:0";
		keypad = "/fragment@44:target:0";
	};

	__local_fixups__ {

		fragment@2 {

			__overlay__ {

				cam_vdd_ext {
					pinctrl-0 = <0x00>;
					pinctrl-1 = <0x00>;
					pinctrl-2 = <0x00>;
				};

				flashlights_aw36515 {
					pinctrl-0 = <0x00>;
					pinctrl-1 = <0x00>;
					pinctrl-2 = <0x00>;
				};

				flashlights_ocp81375 {
					pinctrl-0 = <0x00>;
					pinctrl-1 = <0x00>;
					pinctrl-2 = <0x00>;
				};

				lens_actuator_main_af {
					pinctrl-0 = <0x00>;
					pinctrl-1 = <0x00>;
					pinctrl-2 = <0x00>;
				};

				fingerprint {
					pinctrl-0 = <0x00>;
					pinctrl-1 = <0x00>;
					pinctrl-2 = <0x00>;
					pinctrl-3 = <0x00>;
					pinctrl-4 = <0x00>;
				};
			};
		};

		fragment@3 {

			__overlay__ {

				fingerprint@0 {
					pinctrl-0 = <0x00>;
					pinctrl-1 = <0x00>;
					pinctrl-2 = <0x00>;
					pinctrl-3 = <0x00>;
					pinctrl-4 = <0x00>;
					pinctrl-5 = <0x00>;
				};
			};
		};

		fragment@5 {

			__overlay__ {
				pinctrl-0 = <0x00>;
				pinctrl-1 = <0x00>;
				pinctrl-2 = <0x00>;
				pinctrl-3 = <0x00>;
				pinctrl-4 = <0x00>;
				pinctrl-5 = <0x00>;
			};
		};

		fragment@11 {

			__overlay__ {
				pinctrl-0 = <0x00>;
				pinctrl-1 = <0x00>;
				pinctrl-2 = <0x00>;
				pinctrl-3 = <0x00>;
				pinctrl-4 = <0x00>;
				pinctrl-5 = <0x00>;
				pinctrl-6 = <0x00>;
			};
		};

		fragment@16 {

			__overlay__ {
				pinctrl-0 = <0x00>;
				pinctrl-1 = <0x00>;
				pinctrl-2 = <0x00>;
			};
		};

		fragment@17 {

			__overlay__ {
				pinctrl-0 = <0x00>;
				pinctrl-1 = <0x00>;
				pinctrl-2 = <0x00>;
			};
		};

		fragment@18 {

			__overlay__ {

				panel1@0 {

					port {

						endpoint {
							remote-endpoint = <0x00>;
						};
					};
				};

				ports {

					port {

						endpoint {
							remote-endpoint = <0x00>;
						};
					};
				};
			};
		};

		fragment@19 {

			__overlay__ {
				pinctrl-0 = <0x00>;
				pinctrl-1 = <0x00>;
			};
		};

		fragment@21 {

			__overlay__ {

				usb_switch {
					pinctrl-0 = <0x00>;
					pinctrl-1 = <0x00>;
					pinctrl-2 = <0x00>;
					pinctrl-3 = <0x00>;
					pinctrl-4 = <0x00>;
					pinctrl-5 = <0x00>;
					pinctrl-6 = <0x00>;
					pinctrl-7 = <0x00>;
				};
			};
		};

		fragment@46 {

			__overlay__ {
				pinctrl-0 = <0x00>;
				pinctrl-1 = <0x00>;
				pinctrl-2 = <0x00>;
				pinctrl-3 = <0x00>;
				pinctrl-4 = <0x00>;
				pinctrl-5 = <0x00>;
				pinctrl-6 = <0x00>;
				pinctrl-7 = <0x00>;
				pinctrl-8 = <0x00>;
				pinctrl-9 = <0x00>;
				pinctrl-10 = <0x00>;
				pinctrl-11 = <0x00>;
				pinctrl-12 = <0x00>;
				pinctrl-13 = <0x00>;
				pinctrl-14 = <0x00>;
				pinctrl-15 = <0x00>;
				pinctrl-16 = <0x00>;
				pinctrl-17 = <0x00>;
				pinctrl-18 = <0x00>;
				pinctrl-19 = <0x00>;
				pinctrl-20 = <0x00>;
				pinctrl-21 = <0x00>;
				pinctrl-22 = <0x00>;
				pinctrl-23 = <0x00>;
				pinctrl-24 = <0x00>;
				pinctrl-25 = <0x00>;
				pinctrl-26 = <0x00>;
				pinctrl-27 = <0x00>;
				pinctrl-28 = <0x00>;
				pinctrl-29 = <0x00>;
				pinctrl-30 = <0x00>;
				pinctrl-31 = <0x00>;
				pinctrl-32 = <0x00>;
				pinctrl-33 = <0x00>;
				pinctrl-34 = <0x00>;
				pinctrl-35 = <0x00>;
				pinctrl-36 = <0x00>;
				pinctrl-37 = <0x00>;
				pinctrl-38 = <0x00>;
			};
		};
	};
};
